## conf/distro/include/meta-xilinx-tools-default-versions.inc
```bitbake
XILINX_XSCT_VERSION ??= "${@d.getVar("XILINX_RELEASE_VERSION").replace('v','')}"
ESDK_LOCALCONF_ALLOW:append = " XILINX_XSCT_VERSION"

HOSTTOOLS += "ps"

BUILDCFG_VARS:append = " XILINX_XSCT_VERSION"

# Default to XSCT version matching XILINX_RELEASE_VERSION
PREFERRED_VERSION_xsct-native ?= "${XILINX_XSCT_VERSION}"

PREFERRED_VERSION_esw ?= "${XILINX_XSCT_VERSION}"
PREFERRED_VERSION_plm-firmware  ?= "${PREFERRED_VERSION_esw}%"
PREFERRED_VERSION_psm-firmware  ?= "${PREFERRED_VERSION_esw}%"
PREFERRED_VERSION_pmu-firmware  ?= "${PREFERRED_VERSION_esw}%"
PREFERRED_VERSION_fsbl-firmware ?= "${PREFERRED_VERSION_esw}%"

PREFERRED_VERSION_external-hdf          ?= "${XILINX_XSCT_VERSION}%"

PREFERRED_VERSION_openamp-fw-echo-testd ?= "${XILINX_XSCT_VERSION}%"
PREFERRED_VERSION_openamp-fw-mat-muld   ?= "${XILINX_XSCT_VERSION}%"
PREFERRED_VERSION_openamp-fw-rpc-demo   ?= "${XILINX_XSCT_VERSION}%"

require conf/xsct-tarball.inc
```

## conf/layer.conf
```bitbake
# We have a conf and classes directory, add to BBPATH
BBPATH .= ":${LAYERDIR}"

# We have a packages directory, add to BBFILES
BBFILES += " \
    ${LAYERDIR}/recipes-*/*/*.bb \
    ${LAYERDIR}/recipes-*/*/*.bbappend \
    "

BBFILE_COLLECTIONS += "xilinx-tools"
# Needs to be higher priority then meta-xilinx-standalone (7)
BBFILE_PRIORITY_xilinx-tools = "8"
BBFILE_PATTERN_xilinx-tools = "^${LAYERDIR}/"

LAYERDEPENDS_xilinx-tools  = "core xilinx xilinx-standalone"

LAYERSERIES_COMPAT_xilinx-tools = "scarthgap"

# Sanity check for meta-xilinx-standalone layer.
# Setting SKIP_META_XILINX_STANDALONE_SANITY_CHECK to "1" would skip the bbappend files check.
INHERIT += "sanity-meta-xilinx-tools"

# We need to load the ESW and related config components, only if XILINX_WITH_ESW
# is in defined in some way.  Since we don't know the configuration during
# layer.conf load time, we delay using a special bbclass that simply includes
# the META_XILINX_STANDLONE_CONFIG_PATH file.
META_XILINX_TOOLS_CONFIG_PATH = "${LAYERDIR}/conf/distro/include/meta-xilinx-tools-default-versions.inc"

USER_CLASSES:append = " meta-xilinx-tools-cfg"

# We also need to define the XSCT version early, as the machine.conf files
# may need a default version value.
XILINX_XSCT_VERSION ??= "${@(d.getVar("XILINX_RELEASE_VERSION") or 'Undefined').replace('v','')}"

XLNX_SCRIPTS_DIR = "${LAYERDIR}/scripts/"

LAYERBASE_xilinx-tools = "${LAYERDIR}"
```

## conf/machine/ac701-microblazeel-2024.2.conf
```bitbake
#@TYPE: Machine
#@NAME: ac701-microblazeel
#@DESCRIPTION: Machine configuration for the ac701-microblazeel boards.

#### Preamble
MACHINEOVERRIDES =. "${@['', 'ac701-microblazeel:']['ac701-microblazeel' !='${MACHINE}']}"
#### Regular settings follow

# MicroBlaze Tune features Settings
TUNE_FEATURES:tune-microblaze ?= "microblaze v11.0 pattern-compare barrel-shift divide-hard multiply-high fpu-hard reorder"
DEFAULTTUNE ?= "microblaze"

# Yocto device-tree variables
YAML_CONSOLE_DEVICE_CONFIG:pn-device-tree ?= "axi_uartlite_0"
YAML_MAIN_MEMORY_CONFIG:pn-device-tree ?= "mig_7series_0"
DT_PADDING_SIZE:pn-device-tree ?= "0x1000"
DTC_FLAGS:pn-device-tree ?= ""
XSCTH_PROC:pn-device-tree ?= "microblaze_0"
YAML_DT_BOARD_FLAGS ?= "{BOARD ac701-full}"

# Yocto u-boot-xlnx variables
UBOOT_MACHINE ?= "microblaze-generic_defconfig"

# Yocto FS-Boot variables
YAML_SERIAL_CONSOLE_STDIN:pn-fs-boot ?= "axi_uartlite_0"
YAML_SERIAL_CONSOLE_STDOUT:pn-fs-boot ?= "axi_uartlite_0"
YAML_MAIN_MEMORY_CONFIG:pn-fs-boot ?= "mig_7series_0"
YAML_FLASH_MEMORY_CONFIG:pn-fs-boot ?= "axi_quad_spi_0"
XSCTH_PROC:pn-fs-boot ?= "microblaze_0"

# Serial Console Settings
SERIAL_CONSOLES ?= "115200;ttyUL0"
YAML_SERIAL_CONSOLE_BAUDRATE ?= "115200"

# Set DDR Base address for u-boot-xlnx-scr variables
DDR_BASEADDR ?= "0x80000000"
SKIP_APPEND_BASEADDR ?= "0"

# Yocto KERNEL Variables
UBOOT_ENTRYPOINT  ?= "0x80000000"
UBOOT_LOADADDRESS ?= "0x80000000"
KERNEL_EXTRA_ARGS += "UIMAGE_LOADADDR=${UBOOT_ENTRYPOINT}"

QB_MEM = "-m 1024"

# Required generic machine inclusion
require conf/machine/microblaze-generic.conf

# This is an 'XSCT' based BSP
XILINX_XSCT_VERSION = "2024.2"
XILINX_WITH_ESW = "xsct"

# Add system XSA
HDF_URI = "https://petalinux.xilinx.com/sswreleases/rel-v2024.2/hdf-examples/2024.2/2024.2_1104_1_11050118/external/ac701-microblazeel/ac701-microblazeel-2024.2_1104_1.xsa"
HDF_URI[sha256sum] = "326adc14d8c9f3244863c0720d6293e2e5bbbba8d23b5a588df176f246882913"

#### No additional settings should be after the Postamble
#### Postamble
PACKAGE_EXTRA_ARCHS:append = "${@['', ' ac701_microblazeel']['ac701-microblazeel' != '${MACHINE}']}"
```

## conf/machine/ac701-microblazeel.conf
```bitbake
#@TYPE: Machine
#@NAME: ac701-microblazeel
#@DESCRIPTION: Machine configuration for the AC701 evaluation board.

require conf/machine/ac701-microblazeel-${XILINX_XSCT_VERSION}.conf
```

## conf/machine/generic-versal-net-2024.2.conf
```bitbake
#@TYPE: Machine
#@NAME: generic-versal-net
#@DESCRIPTION: Machine configuration for the generic-versal-net boards.

#### Preamble
MACHINEOVERRIDES =. "${@['', 'generic-versal-net:']['generic-versal-net' !='${MACHINE}']}"
#### Regular settings follow

# Yocto device-tree variables
YAML_CONSOLE_DEVICE_CONFIG:pn-device-tree ?= "psx_wizard_0_psxl_0_psx_sbsauart_0"
DT_PADDING_SIZE:pn-device-tree ?= "0x1000"
DTC_FLAGS:pn-device-tree ?= ""
YAML_DT_BOARD_FLAGS ?= "{BOARD versal-net-vn-p-b2197-00-reva}"

# Yocto u-boot-xlnx variables
UBOOT_MACHINE ?= "xilinx_versal_virt_defconfig"

# Yocto PLM variables
YAML_SERIAL_CONSOLE_STDIN:pn-plm-firmware ?= "psx_wizard_0_psxl_0_psx_sbsauart_0"
YAML_SERIAL_CONSOLE_STDOUT:pn-plm-firmware ?= "psx_wizard_0_psxl_0_psx_sbsauart_0"

# Serial Console Settings
SERIAL_CONSOLES ?= "115200;ttyAMA0"
YAML_SERIAL_CONSOLE_BAUDRATE ?= "115200"

# Yocto arm-trusted-firmware(TF-A) variables
ATF_CONSOLE ?= "pl011"

# Set DDR Base address for u-boot-xlnx-scr variables
DDR_BASEADDR ?= "0x0"
SKIP_APPEND_BASEADDR ?= "0"

# Yocto KERNEL Variables
UBOOT_ENTRYPOINT  ?= "0x200000"
UBOOT_LOADADDRESS ?= "0x200000"

QB_MEM = "-m 8G"
QEMU_HW_DTB_PS = "${QEMU_HW_DTB_PATH}/board-versal-net-psx-spp-1.4.dtb"
QEMU_HW_DTB_PMC = "${QEMU_HW_DTB_PATH}/board-versal-pmx-virt.dtb"

# Required generic machine inclusion
require conf/machine/versal-net-generic.conf

# This is an 'XSCT' based BSP
XILINX_XSCT_VERSION = "2024.2"
XILINX_WITH_ESW = "xsct"

# Add system XSA
HDF_URI = "https://petalinux.xilinx.com/sswreleases/rel-v2024.2/hdf-examples/2024.2/2024.2_1104_1_11050118/external/versal-net-generic/versal-net-generic-2024.2_1104_1.xsa"
HDF_URI[sha256sum] = "4043cb697bf442f1a9e3f9be6b671b6a207ec89603c3485a8ac5066602077548"

#### No additional settings should be after the Postamble
#### Postamble
PACKAGE_EXTRA_ARCHS:append = "${@['', ' generic_versal_net']['generic-versal-net' != '${MACHINE}']}"
```

## conf/machine/generic-versal-net-2025.1.conf
```bitbake
#@TYPE: Machine
#@NAME: generic-versal-net
#@DESCRIPTION: Machine configuration for the generic-versal-net boards.

#### Preamble
MACHINEOVERRIDES =. "${@['', 'generic-versal-net:']['generic-versal-net' !='${MACHINE}']}"
#### Regular settings follow

# Yocto device-tree variables
YAML_CONSOLE_DEVICE_CONFIG:pn-device-tree ?= "psx_wizard_0_psxl_0_psx_sbsauart_0"
DT_PADDING_SIZE:pn-device-tree ?= "0x1000"
DTC_FLAGS:pn-device-tree ?= ""
YAML_DT_BOARD_FLAGS ?= "{BOARD versal-net-vn-p-b2197-00-reva}"

# Yocto u-boot-xlnx variables
UBOOT_MACHINE ?= "xilinx_versal_virt_defconfig"

# Yocto PLM variables
YAML_SERIAL_CONSOLE_STDIN:pn-plm-firmware ?= "psx_wizard_0_psxl_0_psx_sbsauart_0"
YAML_SERIAL_CONSOLE_STDOUT:pn-plm-firmware ?= "psx_wizard_0_psxl_0_psx_sbsauart_0"

# Serial Console Settings
SERIAL_CONSOLES ?= "115200;ttyAMA0"
YAML_SERIAL_CONSOLE_BAUDRATE ?= "115200"

# Yocto arm-trusted-firmware(TF-A) variables
TFA_CONSOLE ?= "pl011"

# Set DDR Base address for u-boot-xlnx-scr variables
DDR_BASEADDR ?= "0x0"
SKIP_APPEND_BASEADDR ?= "0"

# Yocto KERNEL Variables
UBOOT_ENTRYPOINT  ?= "0x200000"
UBOOT_LOADADDRESS ?= "0x200000"

# Yocto MACHINE_FEATURES Variable
MACHINE_FEATURES += ""

QB_MEM = "-m 8G"
QEMU_HW_DTB_PS = "${QEMU_HW_DTB_PATH}/board-versal-net-psx-spp-1.4.dtb"
QEMU_HW_DTB_PMC = "${QEMU_HW_DTB_PATH}/board-versal-pmx-virt.dtb"

# Required generic machine inclusion
require conf/machine/versal-net-generic.conf

# This is an 'XSCT' based BSP
XILINX_XSCT_VERSION = "2025.1"
XILINX_WITH_ESW = "xsct"

# Add system XSA
HDF_URI = "https://petalinux.xilinx.com/sswreleases/rel-v2025.1/hdf-examples/2025.1/2025.1_0517_1_05172018/external/versal-net-generic/versal-net-generic-2025.1_0517_1.xsa"
HDF_URI[sha256sum] = "3cf88cb8f81550ae999c25ab7dfe547c138249436f304b5a4c36fe338a64182f"

#### No additional settings should be after the Postamble
#### Postamble
PACKAGE_EXTRA_ARCHS:append = "${@['', ' generic_versal_net']['generic-versal-net' != '${MACHINE}']}"
```

## conf/machine/include/machine-xilinx-zynq.inc
```bitbake
IMAGE_CLASSES_xilinx-hdf_append += " xilinx-bootbin"

#specify BIF partition attributes required for BOOT.bin
BIF_PARTITION_ATTR= "fsbl u-boot"

#specify BIF partition attributes for FSBL
#bootloader is FSBL. Location where FSBL binary is present and dependency to build FSBL
BIF_PARTITION_IMAGE[fsbl]="${DEPLOY_DIR_IMAGE}/fsbl-${MACHINE}.elf"
BIF_PARTITION_DEPENDS[fsbl]="virtual/fsbl"

#specify BIF partition attributes for u-boot
#Location where u-boot binary is present
BIF_PARTITION_IMAGE[u-boot]="${DEPLOY_DIR_IMAGE}/u-boot-${MACHINE}.elf"
```

## conf/machine/kc705-microblazeel-2025.1.conf
```bitbake
#@TYPE: Machine
#@NAME: kc705-microblazeel
#@DESCRIPTION: Machine configuration for the kc705-microblazeel boards.

#### Preamble
MACHINEOVERRIDES =. "${@['', 'kc705-microblazeel:']['kc705-microblazeel' !='${MACHINE}']}"
#### Regular settings follow

# MicroBlaze Tune features Settings
TUNE_FEATURES:tune-microblaze ?= "microblaze v11.0 pattern-compare barrel-shift divide-hard multiply-high fpu-hard reorder"
DEFAULTTUNE ?= "microblaze"

# Yocto device-tree variables
YAML_CONSOLE_DEVICE_CONFIG:pn-device-tree ?= "axi_uartlite_0"
YAML_MAIN_MEMORY_CONFIG:pn-device-tree ?= "mig_7series_0"
DT_PADDING_SIZE:pn-device-tree ?= "0x1000"
DTC_FLAGS:pn-device-tree ?= ""
XSCTH_PROC:pn-device-tree ?= "microblaze_0"
YAML_DT_BOARD_FLAGS ?= "{BOARD kc705-full}"

# Yocto u-boot-xlnx variables
UBOOT_MACHINE ?= "microblaze-generic_defconfig"

# Yocto FS-Boot variables
YAML_SERIAL_CONSOLE_STDIN:pn-fs-boot ?= "axi_uartlite_0"
YAML_SERIAL_CONSOLE_STDOUT:pn-fs-boot ?= "axi_uartlite_0"
YAML_MAIN_MEMORY_CONFIG:pn-fs-boot ?= "mig_7series_0"
YAML_FLASH_MEMORY_CONFIG:pn-fs-boot ?= "axi_emc_0"
XSCTH_PROC:pn-fs-boot ?= "microblaze_0"

# Serial Console Settings
SERIAL_CONSOLES ?= "115200;ttyUL0"
YAML_SERIAL_CONSOLE_BAUDRATE ?= "115200"

# Set DDR Base address for u-boot-xlnx-scr variables
DDR_BASEADDR ?= "0x80000000"
SKIP_APPEND_BASEADDR ?= "0"

# Yocto KERNEL Variables
UBOOT_ENTRYPOINT  ?= "0x80000000"
UBOOT_LOADADDRESS ?= "0x80000000"
KERNEL_EXTRA_ARGS += "UIMAGE_LOADADDR=${UBOOT_ENTRYPOINT}"

QB_MEM = "-m 1024"

# Required generic machine inclusion
require conf/machine/microblaze-generic.conf

# This is an 'XSCT' based BSP
XILINX_XSCT_VERSION = "2025.1"
XILINX_WITH_ESW = "xsct"

# Add system XSA
HDF_URI = "https://petalinux.xilinx.com/sswreleases/rel-v2025.1/hdf-examples/2025.1/2025.1_0517_1_05172018/external/kc705-microblazeel/kc705-microblazeel-2025.1_0517_1.xsa"
HDF_URI[sha256sum] = "6261e580a2f9db59af5056da83f900d8d2a22a40c513c5a8e645e6072acf996a"

#### No additional settings should be after the Postamble
#### Postamble
PACKAGE_EXTRA_ARCHS:append = "${@['', ' kc705_microblazeel']['kc705-microblazeel' != '${MACHINE}']}"
```

## conf/machine/kc705-microblazeel-2025.2.conf
```bitbake
#@TYPE: Machine
#@NAME: kc705-microblazeel
#@DESCRIPTION: Machine configuration for the kc705-microblazeel boards.


#### Preamble
MACHINEOVERRIDES =. "${@['', 'kc705-microblazeel:']['kc705-microblazeel' !='${MACHINE}']}"
#### Regular settings follow

# MicroBlaze Tune features Settings
TUNE_FEATURES:tune-microblaze ?= "microblaze v11.0 pattern-compare barrel-shift divide-hard multiply-high fpu-hard reorder"
DEFAULTTUNE ?= "microblaze"

# Yocto device-tree variables
YAML_CONSOLE_DEVICE_CONFIG:pn-device-tree ?= "axi_uartlite_0"
YAML_MAIN_MEMORY_CONFIG:pn-device-tree ?= "mig_7series_0"
DT_PADDING_SIZE:pn-device-tree ?= "0x1000"
DTC_FLAGS:pn-device-tree ?= ""
XSCTH_PROC:pn-device-tree ?= "microblaze_0"
YAML_DT_BOARD_FLAGS ?= "{BOARD kc705-full}"

# Yocto u-boot-xlnx variables
UBOOT_MACHINE ?= "microblaze-generic_defconfig"

# Yocto FS-Boot variables
YAML_SERIAL_CONSOLE_STDIN:pn-fs-boot ?= "axi_uartlite_0"
YAML_SERIAL_CONSOLE_STDOUT:pn-fs-boot ?= "axi_uartlite_0"
YAML_MAIN_MEMORY_CONFIG:pn-fs-boot ?= "mig_7series_0"
YAML_FLASH_MEMORY_CONFIG:pn-fs-boot ?= "axi_emc_0"
XSCTH_PROC:pn-fs-boot ?= "microblaze_0"

# Serial Console Settings
SERIAL_CONSOLES ?= "115200;ttyUL0"
YAML_SERIAL_CONSOLE_BAUDRATE ?= "115200"

# Set DDR Base address for u-boot-xlnx-scr variables
DDR_BASEADDR ?= "0x80000000"
SKIP_APPEND_BASEADDR ?= "0"

# Yocto KERNEL Variables
UBOOT_ENTRYPOINT  ?= "0x80000000"
UBOOT_LOADADDRESS ?= "0x80000000"
KERNEL_EXTRA_ARGS += "UIMAGE_LOADADDR=${UBOOT_ENTRYPOINT}"

QB_MEM = "-m 1024"

# Required generic machine inclusion
require conf/machine/microblaze-generic.conf

# This is an 'XSCT' based BSP
XILINX_XSCT_VERSION = "2025.2"
XILINX_WITH_ESW = "xsct"

# Add system XSA
HDF_URI = "https://edf.amd.com/sswreleases/rel-v2025.2/hdf-examples/2025.2/2025.2_1115_1_11150546/external/kc705-microblazeel/kc705-microblazeel-2025.2_1115_1.xsa"
HDF_URI[sha256sum] = "a4aa4bf5d37a3408c0e114b74909d08cebde0b525a0de57fd7818744d5f22450"

#### No additional settings should be after the Postamble
#### Postamble
PACKAGE_EXTRA_ARCHS:append = "${@['', ' kc705_microblazeel']['kc705-microblazeel' != '${MACHINE}']}"
```

## conf/machine/kc705-microblazeel.conf
```bitbake
#@TYPE: Machine
#@NAME: kc705-microblazeel
#@DESCRIPTION: Machine configuration for the KC705 evaluation board.

require conf/machine/kc705-microblazeel-${XILINX_XSCT_VERSION}.conf
```
