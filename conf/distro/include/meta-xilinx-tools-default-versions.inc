## conf/machine/sp701-microblazeel-2024.2.conf
```bitbake
#@TYPE: Machine
#@NAME: sp701-microblazeel
#@DESCRIPTION: Machine configuration for the sp701-microblazeel boards.

#### Preamble
MACHINEOVERRIDES =. "${@['', 'sp701-microblazeel:']['sp701-microblazeel' !='${MACHINE}']}"
#### Regular settings follow

# MicroBlaze Tune features Settings
TUNE_FEATURES:tune-microblaze ?= "microblaze v11.0 pattern-compare barrel-shift divide-hard multiply-high fpu-hard reorder"
DEFAULTTUNE ?= "microblaze"

# Yocto device-tree variables
YAML_CONSOLE_DEVICE_CONFIG:pn-device-tree ?= "axi_uartlite_0"
YAML_MAIN_MEMORY_CONFIG:pn-device-tree ?= "mig_7series_0"
DT_PADDING_SIZE:pn-device-tree ?= "0x1000"
DTC_FLAGS:pn-device-tree ?= ""
XSCTH_PROC:pn-device-tree ?= "microblaze_0"
YAML_DT_BOARD_FLAGS ?= "{BOARD sp701-rev1.0}"

# Yocto u-boot-xlnx variables
UBOOT_MACHINE ?= "microblaze-generic_defconfig"

# Yocto FS-Boot variables
YAML_SERIAL_CONSOLE_STDIN:pn-fs-boot ?= "axi_uartlite_0"
YAML_SERIAL_CONSOLE_STDOUT:pn-fs-boot ?= "axi_uartlite_0"
YAML_MAIN_MEMORY_CONFIG:pn-fs-boot ?= "mig_7series_0"
YAML_FLASH_MEMORY_CONFIG:pn-fs-boot ?= "axi_quad_spi_0"
XSCTH_PROC:pn-fs-boot ?= "microblaze_0"

# Serial Console Settings
SERIAL_CONSOLES ?= "115200;ttyUL0"
YAML_SERIAL_CONSOLE_BAUDRATE ?= "115200"

# Set DDR Base address for u-boot-xlnx-scr variables
DDR_BASEADDR ?= "0x80000000"
SKIP_APPEND_BASEADDR ?= "0"

# Yocto KERNEL Variables
UBOOT_ENTRYPOINT  ?= "0x80000000"
UBOOT_LOADADDRESS ?= "0x80000000"
KERNEL_EXTRA_ARGS += "UIMAGE_LOADADDR=${UBOOT_ENTRYPOINT}"

QB_MEM = "-m 2G"

# Required generic machine inclusion
require conf/machine/microblaze-generic.conf

# This is an 'XSCT' based BSP
XILINX_XSCT_VERSION = "2024.2"
XILINX_WITH_ESW = "xsct"

# Add system XSA
HDF_URI = "https://petalinux.xilinx.com/sswreleases/rel-v2024.2/hdf-examples/2024.2/2024.2_1104_1_11050118/external/sp701-microblazeel/sp701-microblazeel-2024.2_1104_1.xsa"
HDF_URI[sha256sum] = "13ece1ee3f8d6ab006c6f3681562727d6579ba3170e8fb467b57d9b2eed008b1"

#### No additional settings should be after the Postamble
#### Postamble
PACKAGE_EXTRA_ARCHS:append = "${@['', ' sp701_microblazeel']['sp701-microblazeel' != '${MACHINE}']}"
```

## conf/machine/sp701-microblazeel.conf
```bitbake
#@TYPE: Machine
#@NAME: sp701-microblazeel
#@DESCRIPTION: Machine configuration for the SP701 boards.

require conf/machine/sp701-microblazeel-${XILINX_XSCT_VERSION}.conf
```

## conf/machine/vck190-emmc-versal-2024.1.conf
```bitbake
#@TYPE: Machine
#@NAME: vck190-emmc-versal
#@DESCRIPTION: Machine configuration for the vck190-emmc-versal boards.

#### Preamble
MACHINEOVERRIDES =. "${@['', 'vck190-emmc-versal:']['vck190-emmc-versal' !='${MACHINE}']}"
#### Regular settings follow

# Yocto device-tree variables
YAML_CONSOLE_DEVICE_CONFIG:pn-device-tree ?= "CIPS_0_pspmc_0_psv_sbsauart_0"
YAML_MAIN_MEMORY_CONFIG:pn-device-tree ?= "noc_ddr4_C0_DDR_LOW0"
DT_PADDING_SIZE:pn-device-tree ?= "0x1000"
DTC_FLAGS:pn-device-tree ?= ""
YAML_DT_BOARD_FLAGS ?= "{BOARD versal-vck190-reva-x-ebm-01-reva}"

# Yocto u-boot-xlnx variables
UBOOT_MACHINE ?= "xilinx_versal_virt_defconfig"

# Yocto PLM variables
YAML_SERIAL_CONSOLE_STDIN:pn-plm-firmware ?= "CIPS_0_pspmc_0_psv_sbsauart_0"
YAML_SERIAL_CONSOLE_STDOUT:pn-plm-firmware ?= "CIPS_0_pspmc_0_psv_sbsauart_0"

# Serial Console Settings
SERIAL_CONSOLES ?= "115200;ttyAMA0"
YAML_SERIAL_CONSOLE_BAUDRATE ?= "115200"

# Yocto arm-trusted-firmware(TF-A) variables
ATF_CONSOLE ?= "pl011"
TFA_BL33_LOAD ?= "0x8000000"

# Set DDR Base address for u-boot-xlnx-scr variables
DDR_BASEADDR ?= "0x0"
SKIP_APPEND_BASEADDR ?= "0"

# Yocto KERNEL Variables
UBOOT_ENTRYPOINT  ?= "0x200000"
UBOOT_LOADADDRESS ?= "0x200000"

# Yocto MACHINE_FEATURES Variable
MACHINE_FEATURES += "aie"

QB_MEM = "-m 8G"
QEMU_HW_DTB_PS = "${QEMU_HW_DTB_PATH}/board-versal-ps-vck190.dtb"
QEMU_HW_DTB_PMC = "${QEMU_HW_DTB_PATH}/board-versal-pmc-virt.dtb"

# Required generic machine inclusion
require conf/machine/versal-generic.conf

# This is an 'XSCT' based BSP
XILINX_XSCT_VERSION = "2024.1"
XILINX_WITH_ESW = "xsct"

# Add system XSA
HDF_URI = "https://petalinux.xilinx.com/sswreleases/rel-v2024/hdf-examples/2024.1/2024.1_0515_1_05160530/external/vck190-emmc-versal/vck190-emmc-versal-2024.1_0515_1.xsa"
HDF_URI[sha256sum] = "aa673e7a65c0180b89be9ed495582a5aa3bea1218a5bbc78cac3713b7adac206"

#### No additional settings should be after the Postamble
#### Postamble
PACKAGE_EXTRA_ARCHS:append = "${@['', ' vck190_emmc_versal']['vck190-emmc-versal' != '${MACHINE}']}"
```

## conf/machine/vck190-emmc-versal.conf
```bitbake
#@TYPE: Machine
#@NAME: vck190-emmc-versal
#@DESCRIPTION: Machine configuration for the vck190-emmc-versal boards.

require conf/machine/vck190-emmc-versal-${XILINX_XSCT_VERSION}.conf
```

## conf/machine/vck190-ospi-versal.conf
```bitbake
#@TYPE: Machine
#@NAME: vck190-ospi-versal
#@DESCRIPTION: Machine configuration for the vck190-ospi-versal boards.

require conf/machine/vck190-ospi-versal-${XILINX_XSCT_VERSION}.conf
```

## conf/machine/vck190-versal-2023.1.conf
```bitbake
#@TYPE: Machine
#@NAME: vck190-versal
#@DESCRIPTION: Machine configuration for the vck190-versal boards.

#### Preamble
MACHINEOVERRIDES =. "${@['', 'vck190-versal:']['vck190-versal' !='${MACHINE}']}"
#### Regular settings follow

# Yocto device-tree variables
YAML_CONSOLE_DEVICE_CONFIG:pn-device-tree ?= "CIPS_0_pspmc_0_psv_sbsauart_0"
YAML_MAIN_MEMORY_CONFIG:pn-device-tree ?= "noc_ddr4_C0_DDR_LOW0"
DT_PADDING_SIZE:pn-device-tree ?= "0x1000"
DTC_FLAGS:pn-device-tree ?= ""
YAML_DT_BOARD_FLAGS ?= "{BOARD versal-vck190-reva-x-ebm-01-reva}"

# Yocto u-boot-xlnx variables
UBOOT_MACHINE ?= "xilinx_versal_virt_defconfig"

# Yocto PLM variables
YAML_SERIAL_CONSOLE_STDIN:pn-plm-firmware ?= "CIPS_0_pspmc_0_psv_sbsauart_0"
YAML_SERIAL_CONSOLE_STDOUT:pn-plm-firmware ?= "CIPS_0_pspmc_0_psv_sbsauart_0"

# Serial Console Settings
SERIAL_CONSOLES ?= "115200;ttyAMA0"
YAML_SERIAL_CONSOLE_BAUDRATE ?= "115200"

# Yocto arm-trusted-firmware(TF-A) variables
ATF_CONSOLE ?= "pl011"
TFA_BL33_LOAD ?= "0x8000000"

# Set DDR Base address for u-boot-xlnx-scr variables
DDR_BASEADDR ?= "0x0"
SKIP_APPEND_BASEADDR ?= "0"

# Yocto KERNEL Variables
UBOOT_ENTRYPOINT  ?= "0x200000"
UBOOT_LOADADDRESS ?= "0x200000"

# Yocto MACHINE_FEATURES Variable
MACHINE_FEATURES += "aie"

QB_MEM = "-m 8G"
QEMU_HW_DTB_PS = "${QEMU_HW_DTB_PATH}/board-versal-ps-vck190.dtb"
QEMU_HW_DTB_PMC = "${QEMU_HW_DTB_PATH}/board-versal-pmc-virt.dtb"

# Required generic machine inclusion
require conf/machine/versal-generic.conf

# This is an 'XSCT' based BSP
XILINX_XSCT_VERSION = "2023.1"
XILINX_WITH_ESW = "xsct"

# Add system XSA
HDF_URI = "https://petalinux.xilinx.com/sswreleases/rel-v2023/hdf-examples/2023.1/2023.1_0426_1_04270351/vck190-versal/vck190-versal-2023.1_0426_1.xsa"
HDF_URI[sha256sum] = "041634eae4480ad56a9c4b0f97bbedfd4dc54dfceaacb5ae443e9a97d5f5bdee"

#### No additional settings should be after the Postamble
#### Postamble
PACKAGE_EXTRA_ARCHS:append = "${@['', ' vck190_versal']['vck190-versal' != '${MACHINE}']}"
```

## conf/machine/vck190-versal.conf
```bitbake
#@TYPE: Machine
#@NAME: vck190-versal
#@DESCRIPTION: Machine configuration for the VCK190 evaluation board.

require conf/machine/vck190-versal-${XILINX_XSCT_VERSION}.conf
```

## conf/machine/vcu118-microblazeel-2023.1.conf
```bitbake
#@TYPE: Machine
#@NAME: vcu118-microblazeel
#@DESCRIPTION: Machine configuration for the vcu118-microblazeel boards.

#### Preamble
MACHINEOVERRIDES =. "${@['', 'vcu118-microblazeel:']['vcu118-microblazeel' !='${MACHINE}']}"
#### Regular settings follow

# MicroBlaze Tune features Settings
TUNE_FEATURES:tune-microblaze ?= "microblaze v11.0 pattern-compare barrel-shift divide-hard multiply-high fpu-hard reorder"
DEFAULTTUNE ?= "microblaze"

# Yocto device-tree variables
YAML_CONSOLE_DEVICE_CONFIG:pn-device-tree ?= "axi_uartlite_0"
YAML_MAIN_MEMORY_CONFIG:pn-device-tree ?= "ddr4_0"
DT_PADDING_SIZE:pn-device-tree ?= "0x1000"
DTC_FLAGS:pn-device-tree ?= ""
XSCTH_PROC:pn-device-tree ?= "microblaze_0"
YAML_DT_BOARD_FLAGS ?= "{BOARD vcu118-rev2.0}"

# Yocto u-boot-xlnx variables
UBOOT_MACHINE ?= "microblaze-generic_defconfig"

# Yocto FS-Boot variables
YAML_SERIAL_CONSOLE_STDIN:pn-fs-boot ?= "axi_uartlite_0"
YAML_SERIAL_CONSOLE_STDOUT:pn-fs-boot ?= "axi_uartlite_0"
YAML_MAIN_MEMORY_CONFIG:pn-fs-boot ?= "ddr4_0"
YAML_FLASH_MEMORY_CONFIG:pn-fs-boot ?= "axi_quad_spi_0"
XSCTH_PROC:pn-fs-boot ?= "microblaze_0"

# Serial Console Settings
SERIAL_CONSOLES ?= "115200;ttyUL0"
YAML_SERIAL_CONSOLE_BAUDRATE ?= "115200"

# Set DDR Base address for u-boot-xlnx-scr variables
DDR_BASEADDR ?= "0x80000000"
SKIP_APPEND_BASEADDR ?= "0"

# Yocto KERNEL Variables
UBOOT_ENTRYPOINT  ?= "0x80000000"
UBOOT_LOADADDRESS ?= "0x80000000"
KERNEL_EXTRA_ARGS += "UIMAGE_LOADADDR=${UBOOT_ENTRYPOINT}"

QB_MEM = "-m 4G"

# Required generic machine inclusion
require conf/machine/microblaze-generic.conf

# This is an 'XSCT' based BSP
XILINX_XSCT_VERSION = "2023.1"
XILINX_WITH_ESW = "xsct"

# Add system XSA
HDF_URI = "https://petalinux.xilinx.com/sswreleases/rel-v2023/hdf-examples/2023.1/2023.1_0426_1_04270351/vcu118-microblazeel/vcu118-microblazeel-2023.1_0426_1.xsa"
HDF_URI[sha256sum] = "52dd56bf871a2b31660dadcbf116b529c28104996c6f56aaa604c80271009e97"

#### No additional settings should be after the Postamble
#### Postamble
PACKAGE_EXTRA_ARCHS:append = "${@['', ' vcu118_microblazeel']['vcu118-microblazeel' != '${MACHINE}']}"
```
