## conf/machine/kcu105-microblazeel-2024.1.conf
```bitbake
#@TYPE: Machine
#@NAME: kcu105-microblazeel
#@DESCRIPTION: Machine configuration for the kcu105-microblazeel boards.

#### Preamble
MACHINEOVERRIDES =. "${@['', 'kcu105-microblazeel:']['kcu105-microblazeel' !='${MACHINE}']}"
#### Regular settings follow

# MicroBlaze Tune features Settings
TUNE_FEATURES:tune-microblaze ?= "microblaze v11.0 pattern-compare barrel-shift divide-hard multiply-high fpu-hard reorder"
DEFAULTTUNE ?= "microblaze"

# Yocto device-tree variables
YAML_CONSOLE_DEVICE_CONFIG:pn-device-tree ?= "axi_uartlite_0"
YAML_MAIN_MEMORY_CONFIG:pn-device-tree ?= "ddr4_0"
DT_PADDING_SIZE:pn-device-tree ?= "0x1000"
DTC_FLAGS:pn-device-tree ?= ""
XSCTH_PROC:pn-device-tree ?= "microblaze_0"
YAML_DT_BOARD_FLAGS ?= "{BOARD kcu105}"

# Yocto u-boot-xlnx variables
UBOOT_MACHINE ?= "microblaze-generic_defconfig"

# Yocto FS-Boot variables
YAML_SERIAL_CONSOLE_STDIN:pn-fs-boot ?= "axi_uartlite_0"
YAML_SERIAL_CONSOLE_STDOUT:pn-fs-boot ?= "axi_uartlite_0"
YAML_MAIN_MEMORY_CONFIG:pn-fs-boot ?= "ddr4_0"
YAML_FLASH_MEMORY_CONFIG:pn-fs-boot ?= "axi_quad_spi_0"
XSCTH_PROC:pn-fs-boot ?= "microblaze_0"

# Serial Console Settings
SERIAL_CONSOLES ?= "115200;ttyUL0"
YAML_SERIAL_CONSOLE_BAUDRATE ?= "115200"

# Set DDR Base address for u-boot-xlnx-scr variables
DDR_BASEADDR ?= "0x80000000"
SKIP_APPEND_BASEADDR ?= "0"

# Yocto KERNEL Variables
UBOOT_ENTRYPOINT  ?= "0x80000000"
UBOOT_LOADADDRESS ?= "0x80000000"
KERNEL_EXTRA_ARGS += "UIMAGE_LOADADDR=${UBOOT_ENTRYPOINT}"

QB_MEM = "-m 2G"

# Required generic machine inclusion
require conf/machine/microblaze-generic.conf

# This is an 'XSCT' based BSP
XILINX_XSCT_VERSION = "2024.1"
XILINX_WITH_ESW = "xsct"

# Add system XSA
HDF_URI = "https://petalinux.xilinx.com/sswreleases/rel-v2024/hdf-examples/2024.1/2024.1_0515_1_05160530/external/kcu105-microblazeel/kcu105-microblazeel-2024.1_0515_1.xsa"
HDF_URI[sha256sum] = "8032708b167ca4bd7b58d5278456837a807e2ccfbd4da3e201dd685f855ac18a"

#### No additional settings should be after the Postamble
#### Postamble
PACKAGE_EXTRA_ARCHS:append = "${@['', ' kcu105_microblazeel']['kcu105-microblazeel' != '${MACHINE}']}"
```

## conf/machine/kcu105-microblazeel.conf
```bitbake
#@TYPE: Machine
#@NAME: kcu105-microblazeel
#@DESCRIPTION: Machine configuration for the KCU105 evaluation board.

require conf/machine/kcu105-microblazeel-${XILINX_XSCT_VERSION}.conf
```

## conf/machine/qemu-microblazeel.conf
```bitbake
#@TYPE: Machine
#@NAME: qemu-microblazeel
#@DESCRIPTION: Machine configuration for the qemu-microblazeel boards.

#### Preamble
MACHINEOVERRIDES =. "${@['', 'qemu-microblazeel:']['qemu-microblazeel' !='${MACHINE}']}"
#### Regular settings follow

# MicroBlaze Tune features Settings
TUNE_FEATURES:tune-microblaze ?= "microblaze v11.0 pattern-compare barrel-shift divide-hard multiply-high fpu-hard reorder"
DEFAULTTUNE ?= "microblaze"

# Yocto device-tree variables
YAML_CONSOLE_DEVICE_CONFIG:pn-device-tree ?= "axi_uartlite_0"
YAML_MAIN_MEMORY_CONFIG:pn-device-tree ?= "ddr4_0"
DT_PADDING_SIZE:pn-device-tree ?= "0x1000"
DTC_FLAGS:pn-device-tree ?= ""
XSCTH_PROC:pn-device-tree ?= "microblaze_0"
YAML_DT_BOARD_FLAGS ?= "{BOARD kcu105}"

# Yocto u-boot-xlnx variables
UBOOT_MACHINE ?= "microblaze-generic_defconfig"

# Yocto FS-Boot variables
YAML_SERIAL_CONSOLE_STDIN:pn-fs-boot ?= "axi_uartlite_0"
YAML_SERIAL_CONSOLE_STDOUT:pn-fs-boot ?= "axi_uartlite_0"
YAML_MAIN_MEMORY_CONFIG:pn-fs-boot ?= "ddr4_0"
YAML_FLASH_MEMORY_CONFIG:pn-fs-boot ?= "axi_quad_spi_0"
XSCTH_PROC:pn-fs-boot ?= "microblaze_0"

# Serial Console Settings
SERIAL_CONSOLES ?= "115200;ttyUL0"
YAML_SERIAL_CONSOLE_BAUDRATE ?= "115200"

# Set DDR Base address for u-boot-xlnx-scr variables
DDR_BASEADDR ?= "0x80000000"
SKIP_APPEND_BASEADDR ?= "0"

# Yocto KERNEL Variables
UBOOT_ENTRYPOINT  ?= "0x80000000"
UBOOT_LOADADDRESS ?= "0x80000000"
KERNEL_EXTRA_ARGS += "UIMAGE_LOADADDR=${UBOOT_ENTRYPOINT}"

# This machine is NOT designed to be inherited by other machines or used as an
# example of how to create a machine.  It is only useful for running testimage
# with runqemu.

# The following is from conf/machine/include/qemu.inc, but we can not use it
# as it changes other values that need to come from the distro and the
# AMD machine settings
XSERVER ?= "xserver-xorg \
            ${@bb.utils.contains('DISTRO_FEATURES', 'opengl', 'mesa-driver-swrast xserver-xorg-extension-glx', '', d)} \
            xf86-video-fbdev \
            xf86-video-modesetting \
            "

MACHINE_FEATURES = "alsa bluetooth usbgadget screen vfat"

MACHINEOVERRIDES =. "qemuall:"

IMAGE_FSTYPES += "tar.bz2 ext4"

# Don't include kernels in standard images
RDEPENDS:${KERNEL_PACKAGE_NAME}-base = ""

# Provide the nfs server kernel module for all qemu images
KERNEL_FEATURES:append:pn-linux-yocto = " features/nfsd/nfsd-enable.scc"
KERNEL_FEATURES:append:pn-linux-yocto-rt = " features/nfsd/nfsd-enable.scc"
KERNEL_FEATURES:append:pn-linux-xlnx = " features/nfsd/nfsd-enable.scc"

# Required generic machine inclusion
require conf/machine/microblaze-generic.conf

SERIAL_CONSOLES = "115200;ttyUL0 115200;ttyUL1"

QB_MEM = "-m 2G"
QB_XILINX_SERIAL = ""


# This is an 'XSCT' based BSP
XILINX_XSCT_VERSION = "2024.2"
XILINX_WITH_ESW = "xsct"

# Add system XSA
HDF_URI = "https://petalinux.xilinx.com/sswreleases/rel-v2024.2/hdf-examples/2024.2/2024.2_1104_1_11050118/external/kcu105-microblazeel/kcu105-microblazeel-2024.2_1104_1.xsa"
HDF_URI[sha256sum] = "a5d572343780da9eff3c19b143c23d24564e3e6ecbd3990216d8b5e1fdca134d"

#### No additional settings should be after the Postamble
#### Postamble
PACKAGE_EXTRA_ARCHS:append = "${@['', ' qemu_microblazeel']['qemu-microblazeel' != '${MACHINE}']}"
```

## conf/machine/qemu-versal.conf
```bitbake
#@TYPE: Machine
#@NAME: qemu-versal
#@DESCRIPTION: Machine configuration for the qemu-versal boards.

#### Preamble
MACHINEOVERRIDES =. "${@['', 'qemu-versal:']['qemu-versal' !='${MACHINE}']}"
#### Regular settings follow

# Yocto device-tree variables
YAML_CONSOLE_DEVICE_CONFIG:pn-device-tree ?= "CIPS_0_pspmc_0_psv_sbsauart_0"
YAML_MAIN_MEMORY_CONFIG:pn-device-tree ?= "noc_ddr4_C0_DDR_LOW0"
DT_PADDING_SIZE:pn-device-tree ?= "0x1000"
DTC_FLAGS:pn-device-tree ?= ""
YAML_DT_BOARD_FLAGS ?= "{BOARD versal-vck190-reva-x-ebm-01-reva}"

# Yocto u-boot-xlnx variables
UBOOT_MACHINE ?= "xilinx_versal_virt_defconfig"

# Yocto PLM variables
YAML_SERIAL_CONSOLE_STDIN:pn-plm-firmware ?= "CIPS_0_pspmc_0_psv_sbsauart_0"
YAML_SERIAL_CONSOLE_STDOUT:pn-plm-firmware ?= "CIPS_0_pspmc_0_psv_sbsauart_0"

# Serial Console Settings
SERIAL_CONSOLES ?= "115200;ttyAMA0"
YAML_SERIAL_CONSOLE_BAUDRATE ?= "115200"

# Yocto arm-trusted-firmware(TF-A) variables
ATF_CONSOLE ?= "pl011"
TFA_BL33_LOAD ?= "0x8000000"

# Set DDR Base address for u-boot-xlnx-scr variables
DDR_BASEADDR ?= "0x0"
SKIP_APPEND_BASEADDR ?= "0"

# Yocto KERNEL Variables
UBOOT_ENTRYPOINT  ?= "0x200000"
UBOOT_LOADADDRESS ?= "0x200000"

# Yocto MACHINE_FEATURES Variable
MACHINE_FEATURES += "aie"

# This machine is NOT designed to be inherited by other machines or used as an
# example of how to create a machine.  It is only useful for running testimage
# with runqemu.

# The following is from conf/machine/include/qemu.inc, but we can not use it
# as it changes other values that need to come from the distro and the
# AMD machine settings
XSERVER ?= "xserver-xorg \
            ${@bb.utils.contains('DISTRO_FEATURES', 'opengl', 'mesa-driver-swrast xserver-xorg-extension-glx', '', d)} \
            xf86-video-fbdev \
            xf86-video-modesetting \
            "

MACHINE_FEATURES = "alsa bluetooth usbgadget screen vfat"

MACHINEOVERRIDES =. "qemuall:"

IMAGE_FSTYPES += "tar.bz2 ext4"

# Don't include kernels in standard images
RDEPENDS:${KERNEL_PACKAGE_NAME}-base = ""

# Provide the nfs server kernel module for all qemu images
KERNEL_FEATURES:append:pn-linux-yocto = " features/nfsd/nfsd-enable.scc"
KERNEL_FEATURES:append:pn-linux-yocto-rt = " features/nfsd/nfsd-enable.scc"
KERNEL_FEATURES:append:pn-linux-xlnx = " features/nfsd/nfsd-enable.scc"

MACHINE_FEATURES += "vdu"

# Required generic machine inclusion
require conf/machine/versal-generic.conf

SERIAL_CONSOLES = "115200;ttyAMA0 115200;ttyAMA1"

QB_MEM = "-m 8G"
QEMU_HW_DTB_PS = "${QEMU_HW_DTB_PATH}/board-versal-ps-vck190-alt.dtb"
QEMU_HW_DTB_PMC = "${QEMU_HW_DTB_PATH}/board-versal-pmc-virt-alt.dtb"
QB_XILINX_SERIAL = ""


# This is an 'XSCT' based BSP
XILINX_XSCT_VERSION = "2024.2"
XILINX_WITH_ESW = "xsct"

# Add system XSA
HDF_URI = "https://petalinux.xilinx.com/sswreleases/rel-v2024.2/hdf-examples/2024.2/2024.2_1104_1_11050118/external/vck190-versal/vck190-versal-2024.2_1104_1.xsa"
HDF_URI[sha256sum] = "d7069d991777b704286cc3e3c3414c07802bb92fd38f68760fc463018a7a8ed2"

#### No additional settings should be after the Postamble
#### Postamble
PACKAGE_EXTRA_ARCHS:append = "${@['', ' qemu_versal']['qemu-versal' != '${MACHINE}']}"
```

## conf/machine/qemu-zynq7.conf
```bitbake
#@TYPE: Machine
#@NAME: qemu-zynq7
#@DESCRIPTION: Machine configuration for the qemu-zynq7 boards.

#### Preamble
MACHINEOVERRIDES =. "${@['', 'qemu-zynq7:']['qemu-zynq7' !='${MACHINE}']}"
#### Regular settings follow

# Yocto device-tree variables
YAML_CONSOLE_DEVICE_CONFIG:pn-device-tree ?= "ps7_uart_1"
YAML_MAIN_MEMORY_CONFIG:pn-device-tree ?= "ps7_ddr_0"
DT_PADDING_SIZE:pn-device-tree ?= "0x1000"
DTC_FLAGS:pn-device-tree ?= ""
YAML_DT_BOARD_FLAGS ?= "{BOARD zc702}"

# Yocto u-boot-xlnx variables
UBOOT_MACHINE ?= "xilinx_zynq_virt_defconfig"

# Yocto FSBL variables
YAML_SERIAL_CONSOLE_STDIN:pn-fsbl-firmware ?= "ps7_uart_1"
YAML_SERIAL_CONSOLE_STDOUT:pn-fsbl-firmware ?= "ps7_uart_1"

# Serial Console Settings
SERIAL_CONSOLES ?= "115200;ttyPS0"
YAML_SERIAL_CONSOLE_BAUDRATE ?= "115200"

# Set DDR Base address for u-boot-xlnx-scr variables
DDR_BASEADDR ?= "0x0"
SKIP_APPEND_BASEADDR ?= "0"

# Yocto KERNEL Variables
UBOOT_ENTRYPOINT  ?= "0x200000"
UBOOT_LOADADDRESS ?= "0x200000"
KERNEL_EXTRA_ARGS += "UIMAGE_LOADADDR=${UBOOT_ENTRYPOINT}"

# This machine is NOT designed to be inherited by other machines or used as an
# example of how to create a machine.  It is only useful for running testimage
# with runqemu.

# The following is from conf/machine/include/qemu.inc, but we can not use it
# as it changes other values that need to come from the distro and the
# AMD machine settings
XSERVER ?= "xserver-xorg \
            ${@bb.utils.contains('DISTRO_FEATURES', 'opengl', 'mesa-driver-swrast xserver-xorg-extension-glx', '', d)} \
            xf86-video-fbdev \
            xf86-video-modesetting \
            "

MACHINE_FEATURES = "alsa bluetooth usbgadget screen vfat"

MACHINEOVERRIDES =. "qemuall:"

IMAGE_FSTYPES += "tar.bz2 ext4"

# Don't include kernels in standard images
RDEPENDS:${KERNEL_PACKAGE_NAME}-base = ""

# Provide the nfs server kernel module for all qemu images
KERNEL_FEATURES:append:pn-linux-yocto = " features/nfsd/nfsd-enable.scc"
KERNEL_FEATURES:append:pn-linux-yocto-rt = " features/nfsd/nfsd-enable.scc"
KERNEL_FEATURES:append:pn-linux-xlnx = " features/nfsd/nfsd-enable.scc"

# Required generic machine inclusion
require conf/machine/zynq-generic.conf

SERIAL_CONSOLES = "115200;ttyPS0 115200;ttyPS1"

QB_MEM = "-m 1024"
QB_XILINX_SERIAL = ""


# This is an 'XSCT' based BSP
XILINX_XSCT_VERSION = "2024.2"
XILINX_WITH_ESW = "xsct"

# Add system XSA
HDF_URI = "https://petalinux.xilinx.com/sswreleases/rel-v2024.2/hdf-examples/2024.2/2024.2_1104_1_11050118/external/zc702-zynq7/zc702-zynq7-2024.2_1104_1.xsa"
HDF_URI[sha256sum] = "91b45d3f11ad606b8cc30ac1fc00f69a814f0c64fb2bb9ee5fbe631a2110cd56"

#### No additional settings should be after the Postamble
#### Postamble
PACKAGE_EXTRA_ARCHS:append = "${@['', ' qemu_zynq7']['qemu-zynq7' != '${MACHINE}']}"
```

## conf/machine/qemu-zynqmp.conf
```bitbake
#@TYPE: Machine
#@NAME: qemu-zynqmp
#@DESCRIPTION: Machine configuration for the qemu-zynqmp boards.

#### Preamble
MACHINEOVERRIDES =. "${@['', 'qemu-zynqmp:']['qemu-zynqmp' !='${MACHINE}']}"
#### Regular settings follow

# Yocto device-tree variables
YAML_CONSOLE_DEVICE_CONFIG:pn-device-tree ?= "psu_uart_0"
YAML_MAIN_MEMORY_CONFIG:pn-device-tree ?= "psu_ddr_0"
DT_PADDING_SIZE:pn-device-tree ?= "0x1000"
DTC_FLAGS:pn-device-tree ?= ""
YAML_DT_BOARD_FLAGS ?= "{BOARD zcu102-rev1.0}"

# Yocto u-boot-xlnx variables
UBOOT_MACHINE ?= "xilinx_zynqmp_virt_defconfig"

# Yocto PMUFW variables
YAML_COMPILER_FLAGS:append:pn-pmu-firmware = " "
YAML_SERIAL_CONSOLE_STDIN:pn-pmu-firmware ?= "psu_uart_0"
YAML_SERIAL_CONSOLE_STDOUT:pn-pmu-firmware ?= "psu_uart_0"

# Yocto FSBL variables
YAML_SERIAL_CONSOLE_STDIN:pn-fsbl-firmware ?= "psu_uart_0"
YAML_SERIAL_CONSOLE_STDOUT:pn-fsbl-firmware ?= "psu_uart_0"

# Serial Console Settings
SERIAL_CONSOLES ?= "115200;ttyPS0"
YAML_SERIAL_CONSOLE_BAUDRATE ?= "115200"

# Yocto arm-trusted-firmware(TF-A) variables
ATF_CONSOLE ?= "cadence"
TFA_BL33_LOAD ?= "0x8000000"

# Set DDR Base address for u-boot-xlnx-scr variables
DDR_BASEADDR ?= "0x0"
SKIP_APPEND_BASEADDR ?= "0"

# Yocto KERNEL Variables
UBOOT_ENTRYPOINT  ?= "0x200000"
UBOOT_LOADADDRESS ?= "0x200000"

# Yocto MACHINE_FEATURES Variable
MACHINE_FEATURES += "mali400"

# This machine is NOT designed to be inherited by other machines or used as an
# example of how to create a machine.  It is only useful for running testimage
# with runqemu.

# The following is from conf/machine/include/qemu.inc, but we can not use it
# as it changes other values that need to come from the distro and the
# AMD machine settings
XSERVER ?= "xserver-xorg \
            ${@bb.utils.contains('DISTRO_FEATURES', 'opengl', 'mesa-driver-swrast xserver-xorg-extension-glx', '', d)} \
            xf86-video-fbdev \
            xf86-video-modesetting \
            "

MACHINE_FEATURES = "alsa bluetooth usbgadget screen vfat"

MACHINEOVERRIDES =. "qemuall:"

IMAGE_FSTYPES += "tar.bz2 ext4"

# Don't include kernels in standard images
RDEPENDS:${KERNEL_PACKAGE_NAME}-base = ""

# Provide the nfs server kernel module for all qemu images
KERNEL_FEATURES:append:pn-linux-yocto = " features/nfsd/nfsd-enable.scc"
KERNEL_FEATURES:append:pn-linux-yocto-rt = " features/nfsd/nfsd-enable.scc"
KERNEL_FEATURES:append:pn-linux-xlnx = " features/nfsd/nfsd-enable.scc"

MACHINE_FEATURES += "vcu"
MACHINE_FEATURES += "rfsoc"

# Required generic machine inclusion
require conf/machine/zynqmp-generic.conf

SERIAL_CONSOLES = "115200;ttyPS0 115200;ttyPS1"

QB_MEM = "-m 4G"
QEMU_HW_DTB_PS = "${QEMU_HW_DTB_PATH}/zcu102-arm.dtb"
QEMU_HW_DTB_PMU = "${QEMU_HW_DTB_PATH}/zynqmp-pmu.dtb"
QB_XILINX_SERIAL = ""


# This is an 'XSCT' based BSP
XILINX_XSCT_VERSION = "2024.2"
XILINX_WITH_ESW = "xsct"

# Add system XSA
HDF_URI = "https://petalinux.xilinx.com/sswreleases/rel-v2024.2/hdf-examples/2024.2/2024.2_1104_1_11050118/external/zcu102-zynqmp/zcu102-zynqmp-2024.2_1104_1.xsa"
HDF_URI[sha256sum] = "4fcd33f790484f0e6dde5ea32aa04a82a37eea5be4ca0ccf10c3f627b2cbf57f"

#### No additional settings should be after the Postamble
#### Postamble
PACKAGE_EXTRA_ARCHS:append = "${@['', ' qemu_zynqmp']['qemu-zynqmp' != '${MACHINE}']}"
```
