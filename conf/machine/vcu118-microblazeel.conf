## conf/machine/vcu118-microblazeel.conf
```bitbake
#@TYPE: Machine
#@NAME: vcu118-microblazeel
#@DESCRIPTION: Machine configuration for the VCU118 evaluation board.

require conf/machine/vcu118-microblazeel-${XILINX_XSCT_VERSION}.conf
```

## conf/machine/vek280-versal-2024.2.conf
```bitbake
#@TYPE: Machine
#@NAME: vek280-versal
#@DESCRIPTION: Machine configuration for the vek280-versal boards.

#### Preamble
MACHINEOVERRIDES =. "${@['', 'vek280-versal:']['vek280-versal' !='${MACHINE}']}"
#### Regular settings follow

# Yocto device-tree variables
YAML_CONSOLE_DEVICE_CONFIG:pn-device-tree ?= "CIPS_0_pspmc_0_psv_sbsauart_0"
YAML_MAIN_MEMORY_CONFIG:pn-device-tree ?= "noc_ddr4_C0_DDR_LOW0"
DT_PADDING_SIZE:pn-device-tree ?= "0x1000"
DTC_FLAGS:pn-device-tree ?= ""
YAML_DT_BOARD_FLAGS ?= "{BOARD versal-vek280-revb}"

# Yocto u-boot-xlnx variables
UBOOT_MACHINE ?= "xilinx_versal_virt_defconfig"

# Yocto PLM variables
YAML_SERIAL_CONSOLE_STDIN:pn-plm-firmware ?= "CIPS_0_pspmc_0_psv_sbsauart_0"
YAML_SERIAL_CONSOLE_STDOUT:pn-plm-firmware ?= "CIPS_0_pspmc_0_psv_sbsauart_0"

# Serial Console Settings
SERIAL_CONSOLES ?= "115200;ttyAMA0"
YAML_SERIAL_CONSOLE_BAUDRATE ?= "115200"

# Yocto arm-trusted-firmware(TF-A) variables
ATF_CONSOLE ?= "pl011"
TFA_BL33_LOAD ?= "0x8000000"

# Set DDR Base address for u-boot-xlnx-scr variables
DDR_BASEADDR ?= "0x0"
SKIP_APPEND_BASEADDR ?= "0"

# Yocto KERNEL Variables
UBOOT_ENTRYPOINT  ?= "0x200000"
UBOOT_LOADADDRESS ?= "0x200000"

# Yocto MACHINE_FEATURES Variable
MACHINE_FEATURES += "vdu aie"

QB_MEM = "-m 12G"
QEMU_HW_DTB_PS = "${QEMU_HW_DTB_PATH}/board-versal-ps-vek280.dtb"
QEMU_HW_DTB_PMC = "${QEMU_HW_DTB_PATH}/board-versal-pmc-virt.dtb"

# Required generic machine inclusion
require conf/machine/versal-generic.conf

# This is an 'XSCT' based BSP
XILINX_XSCT_VERSION = "2024.2"
XILINX_WITH_ESW = "xsct"

# Add system XSA
HDF_URI = "https://petalinux.xilinx.com/sswreleases/rel-v2024.2/hdf-examples/2024.2/2024.2_1104_1_11050118/external/vek280-versal/vek280-versal-2024.2_1104_1.xsa"
HDF_URI[sha256sum] = "0754be00c9343973078024e4343adb0c1c7fa4e93dc352d693f6cdaae2f29e25"

#### No additional settings should be after the Postamble
#### Postamble
PACKAGE_EXTRA_ARCHS:append = "${@['', ' vek280_versal']['vek280-versal' != '${MACHINE}']}"
```

## conf/machine/vek280-versal.conf
```bitbake
#@TYPE: Machine
#@NAME: vek280-versal
#@DESCRIPTION: Machine configuration for the VEK280 evaluation boards.

require conf/machine/vek280-versal-${XILINX_XSCT_VERSION}.conf
```

## conf/machine/vhk158-versal-2024.2.conf
```bitbake
#@TYPE: Machine
#@NAME: vhk158-versal
#@DESCRIPTION: Machine configuration for the vhk158-versal boards.

#### Preamble
MACHINEOVERRIDES =. "${@['', 'vhk158-versal:']['vhk158-versal' !='${MACHINE}']}"
#### Regular settings follow

# Yocto device-tree variables
YAML_CONSOLE_DEVICE_CONFIG:pn-device-tree ?= "versal_cips_0_pspmc_0_psv_sbsauart_0"
YAML_MAIN_MEMORY_CONFIG:pn-device-tree ?= "axi_noc_0_C0_DDR_LOW0x2"
DT_PADDING_SIZE:pn-device-tree ?= "0x1000"
DTC_FLAGS:pn-device-tree ?= ""
YAML_DT_BOARD_FLAGS ?= "{BOARD versal-vhk158-reva}"

# Yocto u-boot-xlnx variables
UBOOT_MACHINE ?= "xilinx_versal_virt_defconfig"

# Yocto PLM variables
YAML_SERIAL_CONSOLE_STDIN:pn-plm-firmware ?= "versal_cips_0_pspmc_0_psv_sbsauart_0"
YAML_SERIAL_CONSOLE_STDOUT:pn-plm-firmware ?= "versal_cips_0_pspmc_0_psv_sbsauart_0"

# Serial Console Settings
SERIAL_CONSOLES ?= "115200;ttyAMA0"
YAML_SERIAL_CONSOLE_BAUDRATE ?= "115200"

# Yocto arm-trusted-firmware(TF-A) variables
ATF_CONSOLE ?= "pl011"
TFA_BL33_LOAD ?= "0x8000000"

# Set DDR Base address for u-boot-xlnx-scr variables
DDR_BASEADDR ?= "0x0"
SKIP_APPEND_BASEADDR ?= "0"

# Yocto KERNEL Variables
UBOOT_ENTRYPOINT  ?= "0x200000"
UBOOT_LOADADDRESS ?= "0x200000"

QB_MEM = "-m 32G"
QEMU_HW_DTB_PS = "${QEMU_HW_DTB_PATH}/board-versal-ps-vhk158.dtb"
QEMU_HW_DTB_PMC = "${QEMU_HW_DTB_PATH}/board-versal-pmc-virt.dtb"

# Required generic machine inclusion
require conf/machine/versal-generic.conf

# This is an 'XSCT' based BSP
XILINX_XSCT_VERSION = "2024.2"
XILINX_WITH_ESW = "xsct"

# Add system XSA
HDF_URI = "https://petalinux.xilinx.com/sswreleases/rel-v2024.2/hdf-examples/2024.2/2024.2_1104_1_11050118/external/vhk158-versal/vhk158-versal-2024.2_1104_1.xsa"
HDF_URI[sha256sum] = "e58ad298ee7412f1210f2822c4121589ae602aaba9e62feb33d818ade5ca18aa"

#### No additional settings should be after the Postamble
#### Postamble
PACKAGE_EXTRA_ARCHS:append = "${@['', ' vhk158_versal']['vhk158-versal' != '${MACHINE}']}"
```

## conf/machine/vhk158-versal.conf
```bitbake
#@TYPE: Machine
#@NAME: vhk158-versal
#@DESCRIPTION: Machine configuration for the VHK158 evaluation board.

require conf/machine/vhk158-versal-${XILINX_XSCT_VERSION}.conf
```

## conf/machine/vmk180-emmc-versal-2024.2.conf
```bitbake
#@TYPE: Machine
#@NAME: vmk180-emmc-versal
#@DESCRIPTION: Machine configuration for the vmk180-emmc-versal boards.

#### Preamble
MACHINEOVERRIDES =. "${@['', 'vmk180-emmc-versal:']['vmk180-emmc-versal' !='${MACHINE}']}"
#### Regular settings follow

# Yocto device-tree variables
YAML_CONSOLE_DEVICE_CONFIG:pn-device-tree ?= "versal_cips_0_pspmc_0_psv_sbsauart_0"
YAML_MAIN_MEMORY_CONFIG:pn-device-tree ?= "axi_noc_1_C0_DDR_LOW0"
DT_PADDING_SIZE:pn-device-tree ?= "0x1000"
DTC_FLAGS:pn-device-tree ?= ""
YAML_DT_BOARD_FLAGS ?= "{BOARD versal-vmk180-reva-x-ebm-01-reva}"

# Yocto u-boot-xlnx variables
UBOOT_MACHINE ?= "xilinx_versal_virt_defconfig"

# Yocto PLM variables
YAML_SERIAL_CONSOLE_STDIN:pn-plm-firmware ?= "versal_cips_0_pspmc_0_psv_sbsauart_0"
YAML_SERIAL_CONSOLE_STDOUT:pn-plm-firmware ?= "versal_cips_0_pspmc_0_psv_sbsauart_0"

# Serial Console Settings
SERIAL_CONSOLES ?= "115200;ttyAMA0"
YAML_SERIAL_CONSOLE_BAUDRATE ?= "115200"

# Yocto arm-trusted-firmware(TF-A) variables
ATF_CONSOLE ?= "pl011"
TFA_BL33_LOAD ?= "0x8000000"

# Set DDR Base address for u-boot-xlnx-scr variables
DDR_BASEADDR ?= "0x0"
SKIP_APPEND_BASEADDR ?= "0"

# Yocto KERNEL Variables
UBOOT_ENTRYPOINT  ?= "0x200000"
UBOOT_LOADADDRESS ?= "0x200000"

QB_MEM = "-m 8G"
QEMU_HW_DTB_PS = "${QEMU_HW_DTB_PATH}/board-versal-ps-vmk180.dtb"
QEMU_HW_DTB_PMC = "${QEMU_HW_DTB_PATH}/board-versal-pmc-virt.dtb"

# Required generic machine inclusion
require conf/machine/versal-generic.conf

# This is an 'XSCT' based BSP
XILINX_XSCT_VERSION = "2024.2"
XILINX_WITH_ESW = "xsct"

# Add system XSA
HDF_URI = "https://petalinux.xilinx.com/sswreleases/rel-v2024.2/hdf-examples/2024.2/2024.2_1104_1_11050118/external/vmk180-emmc-versal/vmk180-emmc-versal-2024.2_1104_1.xsa"
HDF_URI[sha256sum] = "536de854bd7a62c664f6d8ea4dc51ad22122f819b4011588cc801fb8227cb82e"

#### No additional settings should be after the Postamble
#### Postamble
PACKAGE_EXTRA_ARCHS:append = "${@['', ' vmk180_emmc_versal']['vmk180-emmc-versal' != '${MACHINE}']}"
```

## conf/machine/vmk180-emmc-versal.conf
```bitbake
#@TYPE: Machine
#@NAME: vmk180-emmc-versal
#@DESCRIPTION: Machine configuration for the vmk180-emmc-versal boards.

require conf/machine/vmk180-emmc-versal-${XILINX_XSCT_VERSION}.conf
```

## conf/machine/vmk180-ospi-versal-2025.1.conf
```bitbake
#@TYPE: Machine
#@NAME: vmk180-ospi-versal
#@DESCRIPTION: Machine configuration for the vmk180-ospi-versal boards.

#### Preamble
MACHINEOVERRIDES =. "${@['', 'vmk180-ospi-versal:']['vmk180-ospi-versal' !='${MACHINE}']}"
#### Regular settings follow

# Yocto device-tree variables
YAML_CONSOLE_DEVICE_CONFIG:pn-device-tree ?= "versal_cips_0_pspmc_0_psv_sbsauart_0"
YAML_MAIN_MEMORY_CONFIG:pn-device-tree ?= "axi_noc_1_C0_DDR_LOW0"
DT_PADDING_SIZE:pn-device-tree ?= "0x1000"
DTC_FLAGS:pn-device-tree ?= ""
YAML_DT_BOARD_FLAGS ?= "{BOARD versal-vmk180-reva-x-ebm-01-reva}"

# Yocto u-boot-xlnx variables
UBOOT_MACHINE ?= "xilinx_versal_virt_defconfig"

# Yocto PLM variables
YAML_SERIAL_CONSOLE_STDIN:pn-plm-firmware ?= "versal_cips_0_pspmc_0_psv_sbsauart_0"
YAML_SERIAL_CONSOLE_STDOUT:pn-plm-firmware ?= "versal_cips_0_pspmc_0_psv_sbsauart_0"

# Serial Console Settings
SERIAL_CONSOLES ?= "115200;ttyAMA0"
YAML_SERIAL_CONSOLE_BAUDRATE ?= "115200"

# Yocto arm-trusted-firmware(TF-A) variables
TFA_CONSOLE ?= "pl011"
TFA_BL33_LOAD ?= "0x8000000"

# Set DDR Base address for u-boot-xlnx-scr variables
DDR_BASEADDR ?= "0x0"
SKIP_APPEND_BASEADDR ?= "0"

# Yocto KERNEL Variables
UBOOT_ENTRYPOINT  ?= "0x200000"
UBOOT_LOADADDRESS ?= "0x200000"

# Yocto MACHINE_FEATURES Variable
MACHINE_FEATURES += ""

QB_MEM = "-m 8G"
QEMU_HW_DTB_PS = "${QEMU_HW_DTB_PATH}/board-versal-ps-vmk180.dtb"
QEMU_HW_DTB_PMC = "${QEMU_HW_DTB_PATH}/board-versal-pmc-virt.dtb"

# Required generic machine inclusion
require conf/machine/versal-generic.conf

# This is an 'XSCT' based BSP
XILINX_XSCT_VERSION = "2025.1"
XILINX_WITH_ESW = "xsct"

# Add system XSA
HDF_URI = "https://petalinux.xilinx.com/sswreleases/rel-v2025.1/hdf-examples/2025.1/2025.1_0517_1_05172018/external/vmk180-ospi-versal/vmk180-ospi-versal-2025.1_0517_1.xsa"
HDF_URI[sha256sum] = "e4e76617365b81ddbe72cd9fb8de8523789a6b66682f4da230eaf73a787a74a6"

#### No additional settings should be after the Postamble
#### Postamble
PACKAGE_EXTRA_ARCHS:append = "${@['', ' vmk180_ospi_versal']['vmk180-ospi-versal' != '${MACHINE}']}"
```

## conf/machine/vmk180-ospi-versal.conf
```bitbake
#@TYPE: Machine
#@NAME: vmk180-ospi-versal
#@DESCRIPTION: Machine configuration for the vmk180-ospi-versal boards.

require conf/machine/vmk180-ospi-versal-${XILINX_XSCT_VERSION}.conf
```

## conf/machine/vmk180-versal.conf
```bitbake
#@TYPE: Machine
#@NAME: vmk180-versal
#@DESCRIPTION: Machine configuration for the VMK180 evaluation board.

require conf/machine/vmk180-versal-${XILINX_XSCT_VERSION}.conf
```

## conf/machine/vpk120-versal-2023.2.conf
```bitbake
#@TYPE: Machine
#@NAME: vpk120-versal
#@DESCRIPTION: Machine configuration for the vpk120-versal boards.

#### Preamble
MACHINEOVERRIDES =. "${@['', 'vpk120-versal:']['vpk120-versal' !='${MACHINE}']}"
#### Regular settings follow

# Yocto device-tree variables
YAML_CONSOLE_DEVICE_CONFIG:pn-device-tree ?= "versal_cips_0_pspmc_0_psv_sbsauart_0"
YAML_MAIN_MEMORY_CONFIG:pn-device-tree ?= "axi_noc_1_C0_DDR_LOW0x2"
DT_PADDING_SIZE:pn-device-tree ?= "0x1000"
DTC_FLAGS:pn-device-tree ?= ""
YAML_DT_BOARD_FLAGS ?= "{BOARD versal-vpk120-reva}"

# Yocto u-boot-xlnx variables
UBOOT_MACHINE ?= "xilinx_versal_virt_defconfig"

# Yocto PLM variables
YAML_SERIAL_CONSOLE_STDIN:pn-plm-firmware ?= "versal_cips_0_pspmc_0_psv_sbsauart_0"
YAML_SERIAL_CONSOLE_STDOUT:pn-plm-firmware ?= "versal_cips_0_pspmc_0_psv_sbsauart_0"

# Serial Console Settings
SERIAL_CONSOLES ?= "115200;ttyAMA0"
YAML_SERIAL_CONSOLE_BAUDRATE ?= "115200"

# Yocto arm-trusted-firmware(TF-A) variables
ATF_CONSOLE ?= "pl011"
TFA_BL33_LOAD ?= "0x8000000"

# Set DDR Base address for u-boot-xlnx-scr variables
DDR_BASEADDR ?= "0x0"
SKIP_APPEND_BASEADDR ?= "0"

# Yocto KERNEL Variables
UBOOT_ENTRYPOINT  ?= "0x200000"
UBOOT_LOADADDRESS ?= "0x200000"

QB_MEM = "-m 12G"
QEMU_HW_DTB_PS = "${QEMU_HW_DTB_PATH}/board-versal-ps-vpk120.dtb"
QEMU_HW_DTB_PMC = "${QEMU_HW_DTB_PATH}/board-versal-pmc-virt.dtb"

# Required generic machine inclusion
require conf/machine/versal-generic.conf

# This is an 'XSCT' based BSP
XILINX_XSCT_VERSION = "2023.2"
XILINX_WITH_ESW = "xsct"

# Add system XSA
HDF_URI = "https://petalinux.xilinx.com/sswreleases/rel-v2023/hdf-examples/2023.2/2023.2_1002_1_10030058/external/vpk120-versal/vpk120-versal-2023.2_1002_1.xsa"
HDF_URI[sha256sum] = "c8d69c3e0e97e82e95ad35f09fdac514e1790f2f3444fa60386f013e2a9758af"

#### No additional settings should be after the Postamble
#### Postamble
PACKAGE_EXTRA_ARCHS:append = "${@['', ' vpk120_versal']['vpk120-versal' != '${MACHINE}']}"
```

## conf/machine/vpk120-versal-2024.2.conf
```bitbake
#@TYPE: Machine
#@NAME: vpk120-versal
#@DESCRIPTION: Machine configuration for the vpk120-versal boards.

#### Preamble
MACHINEOVERRIDES =. "${@['', 'vpk120-versal:']['vpk120-versal' !='${MACHINE}']}"
#### Regular settings follow

# Yocto device-tree variables
YAML_CONSOLE_DEVICE_CONFIG:pn-device-tree ?= "versal_cips_0_pspmc_0_psv_sbsauart_0"
YAML_MAIN_MEMORY_CONFIG:pn-device-tree ?= "axi_noc_1_C0_DDR_LOW0x2"
DT_PADDING_SIZE:pn-device-tree ?= "0x1000"
DTC_FLAGS:pn-device-tree ?= ""
YAML_DT_BOARD_FLAGS ?= "{BOARD versal-vpk120-reva}"

# Yocto u-boot-xlnx variables
UBOOT_MACHINE ?= "xilinx_versal_virt_defconfig"

# Yocto PLM variables
YAML_SERIAL_CONSOLE_STDIN:pn-plm-firmware ?= "versal_cips_0_pspmc_0_psv_sbsauart_0"
YAML_SERIAL_CONSOLE_STDOUT:pn-plm-firmware ?= "versal_cips_0_pspmc_0_psv_sbsauart_0"

# Serial Console Settings
SERIAL_CONSOLES ?= "115200;ttyAMA0"
YAML_SERIAL_CONSOLE_BAUDRATE ?= "115200"

# Yocto arm-trusted-firmware(TF-A) variables
ATF_CONSOLE ?= "pl011"
TFA_BL33_LOAD ?= "0x8000000"

# Set DDR Base address for u-boot-xlnx-scr variables
DDR_BASEADDR ?= "0x0"
SKIP_APPEND_BASEADDR ?= "0"

# Yocto KERNEL Variables
UBOOT_ENTRYPOINT  ?= "0x200000"
UBOOT_LOADADDRESS ?= "0x200000"

QB_MEM = "-m 12G"
QEMU_HW_DTB_PS = "${QEMU_HW_DTB_PATH}/board-versal-ps-vpk120.dtb"
QEMU_HW_DTB_PMC = "${QEMU_HW_DTB_PATH}/board-versal-pmc-virt.dtb"

# Required generic machine inclusion
require conf/machine/versal-generic.conf

# This is an 'XSCT' based BSP
XILINX_XSCT_VERSION = "2024.2"
XILINX_WITH_ESW = "xsct"

# Add system XSA
HDF_URI = "https://petalinux.xilinx.com/sswreleases/rel-v2024.2/hdf-examples/2024.2/2024.2_1104_1_11050118/external/vpk120-versal/vpk120-versal-2024.2_1104_1.xsa"
HDF_URI[sha256sum] = "d7cc0d28a03b04278085bb03e05536201306129842db73e79d4b51b7b17b0262"

#### No additional settings should be after the Postamble
#### Postamble
PACKAGE_EXTRA_ARCHS:append = "${@['', ' vpk120_versal']['vpk120-versal' != '${MACHINE}']}"
```

## conf/machine/vpk120-versal.conf
```bitbake
#@TYPE: Machine
#@NAME: vpk120-versal
#@DESCRIPTION: Machine configuration for the VPK120 evaluation board.

require conf/machine/vpk120-versal-${XILINX_XSCT_VERSION}.conf
```

## conf/machine/vpk180-versal-2023.2.conf
```bitbake
#@TYPE: Machine
#@NAME: vpk180-versal
#@DESCRIPTION: Machine configuration for the vpk180-versal boards.

#### Preamble
MACHINEOVERRIDES =. "${@['', 'vpk180-versal:']['vpk180-versal' !='${MACHINE}']}"
#### Regular settings follow

# Yocto device-tree variables
YAML_CONSOLE_DEVICE_CONFIG:pn-device-tree ?= "versal_cips_0_pspmc_0_psv_sbsauart_0"
YAML_MAIN_MEMORY_CONFIG:pn-device-tree ?= "axi_noc_0_C0_DDR_LOW0x2"
DT_PADDING_SIZE:pn-device-tree ?= "0x1000"
DTC_FLAGS:pn-device-tree ?= ""
YAML_DT_BOARD_FLAGS ?= "{BOARD versal-vpk180-reva}"

# Yocto u-boot-xlnx variables
UBOOT_MACHINE ?= "xilinx_versal_virt_defconfig"

# Yocto PLM variables
YAML_SERIAL_CONSOLE_STDIN:pn-plm-firmware ?= "versal_cips_0_pspmc_0_psv_sbsauart_0"
YAML_SERIAL_CONSOLE_STDOUT:pn-plm-firmware ?= "versal_cips_0_pspmc_0_psv_sbsauart_0"

# Serial Console Settings
SERIAL_CONSOLES ?= "115200;ttyAMA0"
YAML_SERIAL_CONSOLE_BAUDRATE ?= "115200"

# Yocto arm-trusted-firmware(TF-A) variables
ATF_CONSOLE ?= "pl011"
TFA_BL33_LOAD ?= "0x8000000"

# Set DDR Base address for u-boot-xlnx-scr variables
DDR_BASEADDR ?= "0x0"
SKIP_APPEND_BASEADDR ?= "0"

# Yocto KERNEL Variables
UBOOT_ENTRYPOINT  ?= "0x200000"
UBOOT_LOADADDRESS ?= "0x200000"

QB_MEM = "-m 12G"
QEMU_HW_DTB_PS = "${QEMU_HW_DTB_PATH}/board-versal-ps-vpk180.dtb"
QEMU_HW_DTB_PMC = "${QEMU_HW_DTB_PATH}/board-versal-pmc-virt.dtb"

# Required generic machine inclusion
require conf/machine/versal-generic.conf

# This is an 'XSCT' based BSP
XILINX_XSCT_VERSION = "2023.2"
XILINX_WITH_ESW = "xsct"

# Add system XSA
HDF_URI = "https://petalinux.xilinx.com/sswreleases/rel-v2023/hdf-examples/2023.2/2023.2_1002_1_10030058/external/vpk180-versal/vpk180-versal-2023.2_1002_1.xsa"
HDF_URI[sha256sum] = "c38c97b47749619c0c3e6996d2d434d0fcc462080405a9f9f9918a2b1452f33e"

#### No additional settings should be after the Postamble
#### Postamble
PACKAGE_EXTRA_ARCHS:append = "${@['', ' vpk180_versal']['vpk180-versal' != '${MACHINE}']}"
```
