## conf/machine/vpk180-versal.conf
```bitbake
#@TYPE: Machine
#@NAME: vpk180-versal
#@DESCRIPTION: Machine configuration for the VPK180 evaluation board.

require conf/machine/vpk180-versal-${XILINX_XSCT_VERSION}.conf
```

## conf/machine/zc702-zynq7-2023.2.conf
```bitbake
#@TYPE: Machine
#@NAME: zc702-zynq7
#@DESCRIPTION: Machine configuration for the zc702-zynq7 boards.

#### Preamble
MACHINEOVERRIDES =. "${@['', 'zc702-zynq7:']['zc702-zynq7' !='${MACHINE}']}"
#### Regular settings follow

# Yocto device-tree variables
YAML_CONSOLE_DEVICE_CONFIG:pn-device-tree ?= "ps7_uart_1"
YAML_MAIN_MEMORY_CONFIG:pn-device-tree ?= "ps7_ddr_0"
DT_PADDING_SIZE:pn-device-tree ?= "0x1000"
DTC_FLAGS:pn-device-tree ?= ""
YAML_DT_BOARD_FLAGS ?= "{BOARD zc702}"

# Yocto u-boot-xlnx variables
UBOOT_MACHINE ?= "xilinx_zynq_virt_defconfig"

# Yocto FSBL variables
YAML_SERIAL_CONSOLE_STDIN:pn-fsbl-firmware ?= "ps7_uart_1"
YAML_SERIAL_CONSOLE_STDOUT:pn-fsbl-firmware ?= "ps7_uart_1"

# Serial Console Settings
SERIAL_CONSOLES ?= "115200;ttyPS0"
YAML_SERIAL_CONSOLE_BAUDRATE ?= "115200"

# Set DDR Base address for u-boot-xlnx-scr variables
DDR_BASEADDR ?= "0x0"
SKIP_APPEND_BASEADDR ?= "0"

# Yocto KERNEL Variables
UBOOT_ENTRYPOINT  ?= "0x200000"
UBOOT_LOADADDRESS ?= "0x200000"
KERNEL_EXTRA_ARGS += "UIMAGE_LOADADDR=${UBOOT_ENTRYPOINT}"

QB_MEM = "-m 1024"
QB_XILINX_SERIAL = "-serial null -serial mon:stdio"

# Required generic machine inclusion
require conf/machine/zynq-generic.conf

# This is an 'XSCT' based BSP
XILINX_XSCT_VERSION = "2023.2"
XILINX_WITH_ESW = "xsct"

# Add system XSA
HDF_URI = "https://petalinux.xilinx.com/sswreleases/rel-v2023/hdf-examples/2023.2/2023.2_1002_1_10030058/external/zc702-zynq7/zc702-zynq7-2023.2_1002_1.xsa"
HDF_URI[sha256sum] = "b9086e721d13aa0ddd3b8a8d9cfcf40fe044e3fb733b6921091f2acfe064fe63"

#### No additional settings should be after the Postamble
#### Postamble
PACKAGE_EXTRA_ARCHS:append = "${@['', ' zc702_zynq7']['zc702-zynq7' != '${MACHINE}']}"
```

## conf/machine/zc702-zynq7-2024.2.conf
```bitbake
#@TYPE: Machine
#@NAME: zc702-zynq7
#@DESCRIPTION: Machine configuration for the zc702-zynq7 boards.

#### Preamble
MACHINEOVERRIDES =. "${@['', 'zc702-zynq7:']['zc702-zynq7' !='${MACHINE}']}"
#### Regular settings follow

# Yocto device-tree variables
YAML_CONSOLE_DEVICE_CONFIG:pn-device-tree ?= "ps7_uart_1"
YAML_MAIN_MEMORY_CONFIG:pn-device-tree ?= "ps7_ddr_0"
DT_PADDING_SIZE:pn-device-tree ?= "0x1000"
DTC_FLAGS:pn-device-tree ?= ""
YAML_DT_BOARD_FLAGS ?= "{BOARD zc702}"

# Yocto u-boot-xlnx variables
UBOOT_MACHINE ?= "xilinx_zynq_virt_defconfig"

# Yocto FSBL variables
YAML_SERIAL_CONSOLE_STDIN:pn-fsbl-firmware ?= "ps7_uart_1"
YAML_SERIAL_CONSOLE_STDOUT:pn-fsbl-firmware ?= "ps7_uart_1"

# Serial Console Settings
SERIAL_CONSOLES ?= "115200;ttyPS0"
YAML_SERIAL_CONSOLE_BAUDRATE ?= "115200"

# Set DDR Base address for u-boot-xlnx-scr variables
DDR_BASEADDR ?= "0x0"
SKIP_APPEND_BASEADDR ?= "0"

# Yocto KERNEL Variables
UBOOT_ENTRYPOINT  ?= "0x200000"
UBOOT_LOADADDRESS ?= "0x200000"
KERNEL_EXTRA_ARGS += "UIMAGE_LOADADDR=${UBOOT_ENTRYPOINT}"

QB_MEM = "-m 1024"
QB_XILINX_SERIAL = "-serial null -serial mon:stdio"

# Required generic machine inclusion
require conf/machine/zynq-generic.conf

# This is an 'XSCT' based BSP
XILINX_XSCT_VERSION = "2024.2"
XILINX_WITH_ESW = "xsct"

# Add system XSA
HDF_URI = "https://petalinux.xilinx.com/sswreleases/rel-v2024.2/hdf-examples/2024.2/2024.2_1104_1_11050118/external/zc702-zynq7/zc702-zynq7-2024.2_1104_1.xsa"
HDF_URI[sha256sum] = "91b45d3f11ad606b8cc30ac1fc00f69a814f0c64fb2bb9ee5fbe631a2110cd56"

#### No additional settings should be after the Postamble
#### Postamble
PACKAGE_EXTRA_ARCHS:append = "${@['', ' zc702_zynq7']['zc702-zynq7' != '${MACHINE}']}"
```

## conf/machine/zc702-zynq7.conf
```bitbake
#@TYPE: Machine
#@NAME: zc702-zynq7
#@DESCRIPTION: Machine configuration for the ZC702 evaluation boards.

require conf/machine/zc702-zynq7-${XILINX_XSCT_VERSION}.conf
```

## conf/machine/zc706-zynq7.conf
```bitbake
#@TYPE: Machine
#@NAME: zc706-zynq7
#@DESCRIPTION: Machine configuration for the ZC706 evaluation boards.

require conf/machine/zc706-zynq7-${XILINX_XSCT_VERSION}.conf
```

## conf/machine/zcu102-zynqmp-2024.1.conf
```bitbake
#@TYPE: Machine
#@NAME: zcu102-zynqmp
#@DESCRIPTION: Machine configuration for the zcu102-zynqmp boards.

#### Preamble
MACHINEOVERRIDES =. "${@['', 'zcu102-zynqmp:']['zcu102-zynqmp' !='${MACHINE}']}"
#### Regular settings follow

# Yocto device-tree variables
YAML_CONSOLE_DEVICE_CONFIG:pn-device-tree ?= "psu_uart_0"
YAML_MAIN_MEMORY_CONFIG:pn-device-tree ?= "psu_ddr_0"
DT_PADDING_SIZE:pn-device-tree ?= "0x1000"
DTC_FLAGS:pn-device-tree ?= ""
YAML_DT_BOARD_FLAGS ?= "{BOARD zcu102-rev1.0}"

# Yocto u-boot-xlnx variables
UBOOT_MACHINE ?= "xilinx_zynqmp_virt_defconfig"

# Yocto PMUFW variables
YAML_COMPILER_FLAGS:append:pn-pmu-firmware = " "
YAML_SERIAL_CONSOLE_STDIN:pn-pmu-firmware ?= "psu_uart_0"
YAML_SERIAL_CONSOLE_STDOUT:pn-pmu-firmware ?= "psu_uart_0"

# Yocto FSBL variables
YAML_SERIAL_CONSOLE_STDIN:pn-fsbl-firmware ?= "psu_uart_0"
YAML_SERIAL_CONSOLE_STDOUT:pn-fsbl-firmware ?= "psu_uart_0"

# Serial Console Settings
SERIAL_CONSOLES ?= "115200;ttyPS0"
YAML_SERIAL_CONSOLE_BAUDRATE ?= "115200"

# Yocto arm-trusted-firmware(TF-A) variables
ATF_CONSOLE ?= "cadence"
TFA_BL33_LOAD ?= "0x8000000"

# Set DDR Base address for u-boot-xlnx-scr variables
DDR_BASEADDR ?= "0x0"
SKIP_APPEND_BASEADDR ?= "0"

# Yocto KERNEL Variables
UBOOT_ENTRYPOINT  ?= "0x200000"
UBOOT_LOADADDRESS ?= "0x200000"

# Yocto MACHINE_FEATURES Variable
MACHINE_FEATURES += "mali400"

QB_MEM = "-m 4G"
QEMU_HW_DTB_PS = "${QEMU_HW_DTB_PATH}/zcu102-arm.dtb"
QEMU_HW_DTB_PMU = "${QEMU_HW_DTB_PATH}/zynqmp-pmu.dtb"

# Required generic machine inclusion
require conf/machine/zynqmp-generic.conf

# This is an 'XSCT' based BSP
XILINX_XSCT_VERSION = "2024.1"
XILINX_WITH_ESW = "xsct"

# Add system XSA
HDF_URI = "https://petalinux.xilinx.com/sswreleases/rel-v2024/hdf-examples/2024.1/2024.1_0515_1_05160530/external/zcu102-zynqmp/zcu102-zynqmp-2024.1_0515_1.xsa"
HDF_URI[sha256sum] = "b29b34028011b558d7a9222d6ce2a3aa4608852d406d3fff8d06a0040cb4fc17"

#### No additional settings should be after the Postamble
#### Postamble
PACKAGE_EXTRA_ARCHS:append = "${@['', ' zcu102_zynqmp']['zcu102-zynqmp' != '${MACHINE}']}"
```

## conf/machine/zcu102-zynqmp.conf
```bitbake
#@TYPE: Machine
#@NAME: zcu102-zynqmp
#@DESCRIPTION: Machine configuration for the ZCU102 evaluation board.

require conf/machine/zcu102-zynqmp-${XILINX_XSCT_VERSION}.conf
```

## conf/machine/zcu104-zynqmp-2024.1.conf
```bitbake
#@TYPE: Machine
#@NAME: zcu104-zynqmp
#@DESCRIPTION: Machine configuration for the zcu104-zynqmp boards.

#### Preamble
MACHINEOVERRIDES =. "${@['', 'zcu104-zynqmp:']['zcu104-zynqmp' !='${MACHINE}']}"
#### Regular settings follow

# Yocto device-tree variables
YAML_CONSOLE_DEVICE_CONFIG:pn-device-tree ?= "psu_uart_0"
YAML_MAIN_MEMORY_CONFIG:pn-device-tree ?= "psu_ddr_0"
DT_PADDING_SIZE:pn-device-tree ?= "0x1000"
DTC_FLAGS:pn-device-tree ?= ""
YAML_DT_BOARD_FLAGS ?= "{BOARD zcu104-revc}"

# Yocto u-boot-xlnx variables
UBOOT_MACHINE ?= "xilinx_zynqmp_virt_defconfig"

# Yocto PMUFW variables
YAML_COMPILER_FLAGS:append:pn-pmu-firmware = " "
YAML_SERIAL_CONSOLE_STDIN:pn-pmu-firmware ?= "psu_uart_0"
YAML_SERIAL_CONSOLE_STDOUT:pn-pmu-firmware ?= "psu_uart_0"

# Yocto FSBL variables
YAML_SERIAL_CONSOLE_STDIN:pn-fsbl-firmware ?= "psu_uart_0"
YAML_SERIAL_CONSOLE_STDOUT:pn-fsbl-firmware ?= "psu_uart_0"

# Serial Console Settings
SERIAL_CONSOLES ?= "115200;ttyPS0"
YAML_SERIAL_CONSOLE_BAUDRATE ?= "115200"

# Yocto arm-trusted-firmware(TF-A) variables
ATF_CONSOLE ?= "cadence"
TFA_BL33_LOAD ?= "0x8000000"

# Set DDR Base address for u-boot-xlnx-scr variables
DDR_BASEADDR ?= "0x0"
SKIP_APPEND_BASEADDR ?= "0"

# Yocto KERNEL Variables
UBOOT_ENTRYPOINT  ?= "0x200000"
UBOOT_LOADADDRESS ?= "0x200000"

# Yocto MACHINE_FEATURES Variable
MACHINE_FEATURES += "vcu mali400"

# Yocto IMAGE_FEATURES Variable
MACHINE_HWCODECS = "libvcu-omxil"
IMAGE_FEATURES += "hwcodecs"

QB_MEM = "-m 4G"
QEMU_HW_DTB_PS = "${QEMU_HW_DTB_PATH}/board-zynqmp-zcu104.dtb"
QEMU_HW_DTB_PMU = "${QEMU_HW_DTB_PATH}/zynqmp-pmu.dtb"

# Required generic machine inclusion
require conf/machine/zynqmp-generic.conf

# This is an 'XSCT' based BSP
XILINX_XSCT_VERSION = "2024.1"
XILINX_WITH_ESW = "xsct"

# Add system XSA
HDF_URI = "https://petalinux.xilinx.com/sswreleases/rel-v2024/hdf-examples/2024.1/2024.1_0515_1_05160530/external/zcu104-zynqmp/zcu104-zynqmp-2024.1_0515_1.xsa"
HDF_URI[sha256sum] = "eb7bcb276c037e76a3f27a9b20f5dc5e5d01d7ae70eedbda4193e68103f7a62f"

#### No additional settings should be after the Postamble
#### Postamble
PACKAGE_EXTRA_ARCHS:append = "${@['', ' zcu104_zynqmp']['zcu104-zynqmp' != '${MACHINE}']}"
```

## conf/machine/zcu104-zynqmp.conf
```bitbake
#@TYPE: Machine
#@NAME: zcu104-zynqmp
#@DESCRIPTION: Machine configuration for the ZCU104 evaluation board.

require conf/machine/zcu104-zynqmp-${XILINX_XSCT_VERSION}.conf
```

## conf/machine/zcu106-zynqmp-2024.2.conf
```bitbake
#@TYPE: Machine
#@NAME: zcu106-zynqmp
#@DESCRIPTION: Machine configuration for the zcu106-zynqmp boards.

#### Preamble
MACHINEOVERRIDES =. "${@['', 'zcu106-zynqmp:']['zcu106-zynqmp' !='${MACHINE}']}"
#### Regular settings follow

# Yocto device-tree variables
YAML_CONSOLE_DEVICE_CONFIG:pn-device-tree ?= "psu_uart_0"
YAML_MAIN_MEMORY_CONFIG:pn-device-tree ?= "psu_ddr_0"
DT_PADDING_SIZE:pn-device-tree ?= "0x1000"
DTC_FLAGS:pn-device-tree ?= ""
YAML_DT_BOARD_FLAGS ?= "{BOARD zcu106-reva}"

# Yocto u-boot-xlnx variables
UBOOT_MACHINE ?= "xilinx_zynqmp_virt_defconfig"

# Yocto PMUFW variables
YAML_COMPILER_FLAGS:append:pn-pmu-firmware = " "
YAML_SERIAL_CONSOLE_STDIN:pn-pmu-firmware ?= "psu_uart_0"
YAML_SERIAL_CONSOLE_STDOUT:pn-pmu-firmware ?= "psu_uart_0"

# Yocto FSBL variables
YAML_SERIAL_CONSOLE_STDIN:pn-fsbl-firmware ?= "psu_uart_0"
YAML_SERIAL_CONSOLE_STDOUT:pn-fsbl-firmware ?= "psu_uart_0"

# Serial Console Settings
SERIAL_CONSOLES ?= "115200;ttyPS0"
YAML_SERIAL_CONSOLE_BAUDRATE ?= "115200"

# Yocto arm-trusted-firmware(TF-A) variables
ATF_CONSOLE ?= "cadence"
TFA_BL33_LOAD ?= "0x8000000"

# Set DDR Base address for u-boot-xlnx-scr variables
DDR_BASEADDR ?= "0x0"
SKIP_APPEND_BASEADDR ?= "0"

# Yocto KERNEL Variables
UBOOT_ENTRYPOINT  ?= "0x200000"
UBOOT_LOADADDRESS ?= "0x200000"

# Yocto MACHINE_FEATURES Variable
MACHINE_FEATURES += "vcu mali400"

# Yocto IMAGE_FEATURES Variable
MACHINE_HWCODECS = "libvcu-omxil"
IMAGE_FEATURES += "hwcodecs"

# Required generic machine inclusion
require conf/machine/zynqmp-generic.conf

# This is an 'XSCT' based BSP
XILINX_XSCT_VERSION = "2024.2"
XILINX_WITH_ESW = "xsct"

# Add system XSA
HDF_URI = "https://petalinux.xilinx.com/sswreleases/rel-v2024.2/hdf-examples/2024.2/2024.2_1104_1_11050118/external/zcu106-zynqmp/zcu106-zynqmp-2024.2_1104_1.xsa"
HDF_URI[sha256sum] = "f6a157ddbe2083ef2f3412695fa2b9ae034f941821ec1558fa4ca298ed305f38"

#### No additional settings should be after the Postamble
#### Postamble
PACKAGE_EXTRA_ARCHS:append = "${@['', ' zcu106_zynqmp']['zcu106-zynqmp' != '${MACHINE}']}"
```

## conf/machine/zcu106-zynqmp.conf
```bitbake
#@TYPE: Machine
#@NAME: zcu106-zynqmp
#@DESCRIPTION: Machine configuration for the ZCU106 evaluation board.

require conf/machine/zcu106-zynqmp-${XILINX_XSCT_VERSION}.conf
```
