## conf/machine/zcu111-zynqmp-2025.1.conf
```bitbake
#@TYPE: Machine
#@NAME: zcu111-zynqmp
#@DESCRIPTION: Machine configuration for the zcu111-zynqmp boards.

#### Preamble
MACHINEOVERRIDES =. "${@['', 'zcu111-zynqmp:']['zcu111-zynqmp' !='${MACHINE}']}"
#### Regular settings follow

# Yocto device-tree variables
YAML_CONSOLE_DEVICE_CONFIG:pn-device-tree ?= "psu_uart_0"
YAML_MAIN_MEMORY_CONFIG:pn-device-tree ?= "psu_ddr_0"
DT_PADDING_SIZE:pn-device-tree ?= "0x1000"
DTC_FLAGS:pn-device-tree ?= ""
YAML_DT_BOARD_FLAGS ?= "{BOARD zcu111-reva}"

# Yocto u-boot-xlnx variables
UBOOT_MACHINE ?= "xilinx_zynqmp_virt_defconfig"

# Yocto PMUFW variables
YAML_COMPILER_FLAGS:append:pn-pmu-firmware = " "
YAML_SERIAL_CONSOLE_STDIN:pn-pmu-firmware ?= "psu_uart_0"
YAML_SERIAL_CONSOLE_STDOUT:pn-pmu-firmware ?= "psu_uart_0"

# Yocto FSBL variables
YAML_SERIAL_CONSOLE_STDIN:pn-fsbl-firmware ?= "psu_uart_0"
YAML_SERIAL_CONSOLE_STDOUT:pn-fsbl-firmware ?= "psu_uart_0"

# Serial Console Settings
SERIAL_CONSOLES ?= "115200;ttyPS0"
YAML_SERIAL_CONSOLE_BAUDRATE ?= "115200"

# Yocto arm-trusted-firmware(TF-A) variables
TFA_CONSOLE ?= "cadence"
TFA_BL33_LOAD ?= "0x8000000"

# Set DDR Base address for u-boot-xlnx-scr variables
DDR_BASEADDR ?= "0x0"
SKIP_APPEND_BASEADDR ?= "0"

# Yocto KERNEL Variables
UBOOT_ENTRYPOINT  ?= "0x200000"
UBOOT_LOADADDRESS ?= "0x200000"

# Yocto MACHINE_FEATURES Variable
MACHINE_FEATURES += "rfsoc"

# Required generic machine inclusion
require conf/machine/zynqmp-generic.conf

# This is an 'XSCT' based BSP
XILINX_XSCT_VERSION = "2025.1"
XILINX_WITH_ESW = "xsct"

# Add system XSA
HDF_URI = "https://petalinux.xilinx.com/sswreleases/rel-v2025.1/hdf-examples/2025.1/2025.1_0517_1_05172018/external/zcu111-zynqmp/zcu111-zynqmp-2025.1_0517_1.xsa"
HDF_URI[sha256sum] = "acd43f58a2a1c656077d1e9e6f754b68d661103aa84caffbc143a2ead2da492e"

#### No additional settings should be after the Postamble
#### Postamble
PACKAGE_EXTRA_ARCHS:append = "${@['', ' zcu111_zynqmp']['zcu111-zynqmp' != '${MACHINE}']}"
```

## conf/machine/zcu111-zynqmp.conf
```bitbake
#@TYPE: Machine
#@NAME: zcu111-zynqmp
#@DESCRIPTION: Machine configuration for the ZCU111 evaluation board.

require conf/machine/zcu111-zynqmp-${XILINX_XSCT_VERSION}.conf
```

## conf/machine/zcu1275-zynqmp-2023.1.conf
```bitbake
#@TYPE: Machine
#@NAME: zcu1275-zynqmp
#@DESCRIPTION: Machine configuration for the zcu1275-zynqmp boards.

#### Preamble
MACHINEOVERRIDES =. "${@['', 'zcu1275-zynqmp:']['zcu1275-zynqmp' !='${MACHINE}']}"
#### Regular settings follow

# Yocto device-tree variables
YAML_CONSOLE_DEVICE_CONFIG:pn-device-tree ?= "psu_uart_0"
YAML_MAIN_MEMORY_CONFIG:pn-device-tree ?= "psu_ddr_0"
DT_PADDING_SIZE:pn-device-tree ?= "0x1000"
DTC_FLAGS:pn-device-tree ?= ""
YAML_DT_BOARD_FLAGS ?= "{BOARD zcu1275-revb}"

# Yocto u-boot-xlnx variables
UBOOT_MACHINE ?= "xilinx_zynqmp_virt_defconfig"

# Yocto PMUFW variables
YAML_COMPILER_FLAGS:append:pn-pmu-firmware = " "
YAML_SERIAL_CONSOLE_STDIN:pn-pmu-firmware ?= "psu_uart_0"
YAML_SERIAL_CONSOLE_STDOUT:pn-pmu-firmware ?= "psu_uart_0"

# Yocto FSBL variables
YAML_SERIAL_CONSOLE_STDIN:pn-fsbl-firmware ?= "psu_uart_0"
YAML_SERIAL_CONSOLE_STDOUT:pn-fsbl-firmware ?= "psu_uart_0"

# Serial Console Settings
SERIAL_CONSOLES ?= "115200;ttyPS0"
YAML_SERIAL_CONSOLE_BAUDRATE ?= "115200"

# Yocto arm-trusted-firmware(TF-A) variables
ATF_CONSOLE ?= "cadence"
TFA_BL33_LOAD ?= "0x8000000"

# Set DDR Base address for u-boot-xlnx-scr variables
DDR_BASEADDR ?= "0x0"
SKIP_APPEND_BASEADDR ?= "0"

# Yocto KERNEL Variables
UBOOT_ENTRYPOINT  ?= "0x200000"
UBOOT_LOADADDRESS ?= "0x200000"

# Yocto MACHINE_FEATURES Variable
MACHINE_FEATURES += "rfsoc"

# Required generic machine inclusion
require conf/machine/zynqmp-generic.conf

# This is an 'XSCT' based BSP
XILINX_XSCT_VERSION = "2023.1"
XILINX_WITH_ESW = "xsct"

# Add system XSA
HDF_URI = "https://petalinux.xilinx.com/sswreleases/rel-v2023/hdf-examples/2023.1/2023.1_0426_1_04270351/zcu1275-zynqmp/zcu1275-zynqmp-2023.1_0426_1.xsa"
HDF_URI[sha256sum] = "d58ea572a547f3e6070c000e266201a8e6d2b5460fcf7b457db58a6dd534e72e"

#### No additional settings should be after the Postamble
#### Postamble
PACKAGE_EXTRA_ARCHS:append = "${@['', ' zcu1275_zynqmp']['zcu1275-zynqmp' != '${MACHINE}']}"
```

## conf/machine/zcu1275-zynqmp.conf
```bitbake
#@TYPE: Machine
#@NAME: zcu1275-zynqmp
#@DESCRIPTION: Machine configuration for the ZCU1275 evaluation board.

require conf/machine/zcu1275-zynqmp-${XILINX_XSCT_VERSION}.conf
```

## conf/machine/zcu1285-zynqmp-2023.1.conf
```bitbake
#@TYPE: Machine
#@NAME: zcu1285-zynqmp
#@DESCRIPTION: Machine configuration for the zcu1285-zynqmp boards.

#### Preamble
MACHINEOVERRIDES =. "${@['', 'zcu1285-zynqmp:']['zcu1285-zynqmp' !='${MACHINE}']}"
#### Regular settings follow

# Yocto device-tree variables
YAML_CONSOLE_DEVICE_CONFIG:pn-device-tree ?= "psu_uart_0"
YAML_MAIN_MEMORY_CONFIG:pn-device-tree ?= "psu_ddr_0"
DT_PADDING_SIZE:pn-device-tree ?= "0x1000"
DTC_FLAGS:pn-device-tree ?= ""
YAML_DT_BOARD_FLAGS ?= "{BOARD zcu1285-reva}"

# Yocto u-boot-xlnx variables
UBOOT_MACHINE ?= "xilinx_zynqmp_virt_defconfig"

# Yocto PMUFW variables
YAML_COMPILER_FLAGS:append:pn-pmu-firmware = " "
YAML_SERIAL_CONSOLE_STDIN:pn-pmu-firmware ?= "psu_uart_0"
YAML_SERIAL_CONSOLE_STDOUT:pn-pmu-firmware ?= "psu_uart_0"

# Yocto FSBL variables
YAML_SERIAL_CONSOLE_STDIN:pn-fsbl-firmware ?= "psu_uart_0"
YAML_SERIAL_CONSOLE_STDOUT:pn-fsbl-firmware ?= "psu_uart_0"

# Serial Console Settings
SERIAL_CONSOLES ?= "115200;ttyPS0"
YAML_SERIAL_CONSOLE_BAUDRATE ?= "115200"

# Yocto arm-trusted-firmware(TF-A) variables
ATF_CONSOLE ?= "cadence"
TFA_BL33_LOAD ?= "0x8000000"

# Set DDR Base address for u-boot-xlnx-scr variables
DDR_BASEADDR ?= "0x0"
SKIP_APPEND_BASEADDR ?= "0"

# Yocto KERNEL Variables
UBOOT_ENTRYPOINT  ?= "0x200000"
UBOOT_LOADADDRESS ?= "0x200000"

# Yocto MACHINE_FEATURES Variable
MACHINE_FEATURES += "rfsoc"

# Required generic machine inclusion
require conf/machine/zynqmp-generic.conf

# This is an 'XSCT' based BSP
XILINX_XSCT_VERSION = "2023.1"
XILINX_WITH_ESW = "xsct"

# Add system XSA
HDF_URI = "https://petalinux.xilinx.com/sswreleases/rel-v2023/hdf-examples/2023.1/2023.1_0426_1_04270351/zcu1285-zynqmp/zcu1285-zynqmp-2023.1_0426_1.xsa"
HDF_URI[sha256sum] = "5e8963a28b30849e1d4f70a449817c797f6cd5143e3c0c0ca1d584e890857e3c"

#### No additional settings should be after the Postamble
#### Postamble
PACKAGE_EXTRA_ARCHS:append = "${@['', ' zcu1285_zynqmp']['zcu1285-zynqmp' != '${MACHINE}']}"
```

## conf/machine/zcu1285-zynqmp.conf
```bitbake
#@TYPE: Machine
#@NAME: zcu1285-zynqmp
#@DESCRIPTION: Machine configuration for the ZCU1285 evaluation board.

require conf/machine/zcu1285-zynqmp-${XILINX_XSCT_VERSION}.conf
```

## conf/machine/zcu208-sdfec-zynqmp-2024.1.conf
```bitbake
#@TYPE: Machine
#@NAME: zcu208-sdfec-zynqmp
#@DESCRIPTION: Machine configuration for the zcu208-sdfec-zynqmp boards.

#### Preamble
MACHINEOVERRIDES =. "${@['', 'zcu208-sdfec-zynqmp:']['zcu208-sdfec-zynqmp' !='${MACHINE}']}"
#### Regular settings follow

# Yocto device-tree variables
YAML_CONSOLE_DEVICE_CONFIG:pn-device-tree ?= "psu_uart_0"
YAML_MAIN_MEMORY_CONFIG:pn-device-tree ?= "psu_ddr_0"
DT_PADDING_SIZE:pn-device-tree ?= "0x1000"
DTC_FLAGS:pn-device-tree ?= ""
YAML_DT_BOARD_FLAGS ?= "{BOARD zcu208-reva}"

# Yocto u-boot-xlnx variables
UBOOT_MACHINE ?= "xilinx_zynqmp_virt_defconfig"

# Yocto PMUFW variables
YAML_COMPILER_FLAGS:append:pn-pmu-firmware = " "
YAML_SERIAL_CONSOLE_STDIN:pn-pmu-firmware ?= "psu_uart_0"
YAML_SERIAL_CONSOLE_STDOUT:pn-pmu-firmware ?= "psu_uart_0"

# Yocto FSBL variables
YAML_SERIAL_CONSOLE_STDIN:pn-fsbl-firmware ?= "psu_uart_0"
YAML_SERIAL_CONSOLE_STDOUT:pn-fsbl-firmware ?= "psu_uart_0"

# Serial Console Settings
SERIAL_CONSOLES ?= "115200;ttyPS0"
YAML_SERIAL_CONSOLE_BAUDRATE ?= "115200"

# Yocto arm-trusted-firmware(TF-A) variables
ATF_CONSOLE ?= "cadence"
TFA_BL33_LOAD ?= "0x8000000"

# Set DDR Base address for u-boot-xlnx-scr variables
DDR_BASEADDR ?= "0x0"
SKIP_APPEND_BASEADDR ?= "0"

# Yocto KERNEL Variables
UBOOT_ENTRYPOINT  ?= "0x200000"
UBOOT_LOADADDRESS ?= "0x200000"

# Yocto MACHINE_FEATURES Variable
MACHINE_FEATURES += "rfsoc"

# Required generic machine inclusion
require conf/machine/zynqmp-generic.conf

# This is an 'XSCT' based BSP
XILINX_XSCT_VERSION = "2024.1"
XILINX_WITH_ESW = "xsct"

# Add system XSA
HDF_URI = "https://petalinux.xilinx.com/sswreleases/rel-v2024/hdf-examples/2024.1/2024.1_0515_1_05160530/external/zcu208-sdfec-zynqmp/zcu208-sdfec-zynqmp-2024.1_0515_1.xsa"
HDF_URI[sha256sum] = "36e8e492c81b4275bdcd987d4a32025bec4f7dd9a61b7ba9b39ab7ab9e79d478"

#### No additional settings should be after the Postamble
#### Postamble
PACKAGE_EXTRA_ARCHS:append = "${@['', ' zcu208_sdfec_zynqmp']['zcu208-sdfec-zynqmp' != '${MACHINE}']}"
```

## conf/machine/zcu208-sdfec-zynqmp-2025.2.conf
```bitbake
#@TYPE: Machine
#@NAME: zcu208-sdfec-zynqmp
#@DESCRIPTION: Machine configuration for the zcu208-sdfec-zynqmp boards.


#### Preamble
MACHINEOVERRIDES =. "${@['', 'zcu208-sdfec-zynqmp:']['zcu208-sdfec-zynqmp' !='${MACHINE}']}"
#### Regular settings follow

# Yocto device-tree variables
YAML_CONSOLE_DEVICE_CONFIG:pn-device-tree ?= "psu_uart_0"
YAML_MAIN_MEMORY_CONFIG:pn-device-tree ?= "psu_ddr_0"
DT_PADDING_SIZE:pn-device-tree ?= "0x1000"
DTC_FLAGS:pn-device-tree ?= ""
YAML_DT_BOARD_FLAGS ?= "{BOARD zcu208-reva}"

# Yocto u-boot-xlnx variables
UBOOT_MACHINE ?= "xilinx_zynqmp_virt_defconfig"

# Yocto PMUFW variables
YAML_COMPILER_FLAGS:append:pn-pmu-firmware = " "
YAML_SERIAL_CONSOLE_STDIN:pn-pmu-firmware ?= "psu_uart_0"
YAML_SERIAL_CONSOLE_STDOUT:pn-pmu-firmware ?= "psu_uart_0"

# Yocto FSBL variables
YAML_SERIAL_CONSOLE_STDIN:pn-fsbl-firmware ?= "psu_uart_0"
YAML_SERIAL_CONSOLE_STDOUT:pn-fsbl-firmware ?= "psu_uart_0"

# Serial Console Settings
SERIAL_CONSOLES ?= "115200;ttyPS0"
YAML_SERIAL_CONSOLE_BAUDRATE ?= "115200"

# Yocto arm-trusted-firmware(TF-A) variables
TFA_CONSOLE ?= "cadence"
TFA_BL33_LOAD ?= "0x8000000"

# Set DDR Base address for u-boot-xlnx-scr variables
DDR_BASEADDR ?= "0x0"
SKIP_APPEND_BASEADDR ?= "0"

# Yocto KERNEL Variables
UBOOT_ENTRYPOINT  ?= "0x200000"
UBOOT_LOADADDRESS ?= "0x200000"

# Yocto MACHINE_FEATURES Variable
MACHINE_FEATURES += "rfsoc"

# Required generic machine inclusion
require conf/machine/zynqmp-generic.conf

# This is an 'XSCT' based BSP
XILINX_XSCT_VERSION = "2025.2"
XILINX_WITH_ESW = "xsct"

# Add system XSA
HDF_URI = "https://edf.amd.com/sswreleases/rel-v2025.2/hdf-examples/2025.2/2025.2_1115_1_11150546/external/zcu208-sdfec-zynqmp/zcu208-sdfec-zynqmp-2025.2_1115_1.xsa"
HDF_URI[sha256sum] = "5e33bf2bd5ad9171eb7522a08d2f98557eb7f1d859dca7645a68d22c5316de68"

#### No additional settings should be after the Postamble
#### Postamble
PACKAGE_EXTRA_ARCHS:append = "${@['', ' zcu208_sdfec_zynqmp']['zcu208-sdfec-zynqmp' != '${MACHINE}']}"
```

## conf/machine/zcu208-sdfec-zynqmp.conf
```bitbake
#@TYPE: Machine
#@NAME: zcu208-sdfec-zynqmp
#@DESCRIPTION: Machine configuration for the zcu208-sdfec-zynqmp boards.

require conf/machine/zcu208-sdfec-zynqmp-${XILINX_XSCT_VERSION}.conf
```

## conf/machine/zcu208-zynqmp-2024.1.conf
```bitbake
#@TYPE: Machine
#@NAME: zcu208-zynqmp
#@DESCRIPTION: Machine configuration for the zcu208-zynqmp boards.

#### Preamble
MACHINEOVERRIDES =. "${@['', 'zcu208-zynqmp:']['zcu208-zynqmp' !='${MACHINE}']}"
#### Regular settings follow

# Yocto device-tree variables
YAML_CONSOLE_DEVICE_CONFIG:pn-device-tree ?= "psu_uart_0"
YAML_MAIN_MEMORY_CONFIG:pn-device-tree ?= "psu_ddr_0"
DT_PADDING_SIZE:pn-device-tree ?= "0x1000"
DTC_FLAGS:pn-device-tree ?= ""
YAML_DT_BOARD_FLAGS ?= "{BOARD zcu208-reva}"

# Yocto u-boot-xlnx variables
UBOOT_MACHINE ?= "xilinx_zynqmp_virt_defconfig"

# Yocto PMUFW variables
YAML_COMPILER_FLAGS:append:pn-pmu-firmware = " "
YAML_SERIAL_CONSOLE_STDIN:pn-pmu-firmware ?= "psu_uart_0"
YAML_SERIAL_CONSOLE_STDOUT:pn-pmu-firmware ?= "psu_uart_0"

# Yocto FSBL variables
YAML_SERIAL_CONSOLE_STDIN:pn-fsbl-firmware ?= "psu_uart_0"
YAML_SERIAL_CONSOLE_STDOUT:pn-fsbl-firmware ?= "psu_uart_0"

# Serial Console Settings
SERIAL_CONSOLES ?= "115200;ttyPS0"
YAML_SERIAL_CONSOLE_BAUDRATE ?= "115200"

# Yocto arm-trusted-firmware(TF-A) variables
ATF_CONSOLE ?= "cadence"
TFA_BL33_LOAD ?= "0x8000000"

# Set DDR Base address for u-boot-xlnx-scr variables
DDR_BASEADDR ?= "0x0"
SKIP_APPEND_BASEADDR ?= "0"

# Yocto KERNEL Variables
UBOOT_ENTRYPOINT  ?= "0x200000"
UBOOT_LOADADDRESS ?= "0x200000"

# Yocto MACHINE_FEATURES Variable
MACHINE_FEATURES += "rfsoc"

# Required generic machine inclusion
require conf/machine/zynqmp-generic.conf

# This is an 'XSCT' based BSP
XILINX_XSCT_VERSION = "2024.1"
XILINX_WITH_ESW = "xsct"

# Add system XSA
HDF_URI = "https://petalinux.xilinx.com/sswreleases/rel-v2024/hdf-examples/2024.1/2024.1_0515_1_05160530/external/zcu208-zynqmp/zcu208-zynqmp-2024.1_0515_1.xsa"
HDF_URI[sha256sum] = "2ef22f0ccfe169b950dc0e7d8acbed9347aac8f9e2396d3c725ed271511324a1"

#### No additional settings should be after the Postamble
#### Postamble
PACKAGE_EXTRA_ARCHS:append = "${@['', ' zcu208_zynqmp']['zcu208-zynqmp' != '${MACHINE}']}"
```

## conf/machine/zcu208-zynqmp.conf
```bitbake
#@TYPE: Machine
#@NAME: zcu208-zynqmp
#@DESCRIPTION: Machine configuration for the ZCU208 evaluation board.

require conf/machine/zcu208-zynqmp-${XILINX_XSCT_VERSION}.conf
```

## conf/machine/zcu216-zynqmp.conf
```bitbake
#@TYPE: Machine
#@NAME: zcu216-zynqmp
#@DESCRIPTION: Machine configuration for the ZCU216 evaluation board.

require conf/machine/zcu216-zynqmp-${XILINX_XSCT_VERSION}.conf
```

## conf/machine/zcu670-zynqmp.conf
```bitbake
#@TYPE: Machine
#@NAME: zcu670-zynqmp
#@DESCRIPTION: Machine configuration for the ZCU670 evaluation board.

require conf/machine/zcu670-zynqmp-${XILINX_XSCT_VERSION}.conf
```
