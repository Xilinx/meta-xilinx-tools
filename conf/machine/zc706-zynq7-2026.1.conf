## conf/machine/zc706-zynq7-2026.1.conf
```bitbake
#@TYPE: Machine
#@NAME: zc706-zynq7
#@DESCRIPTION: Machine configuration for the zc706-zynq7 boards.


#### Preamble
MACHINEOVERRIDES =. "${@['', 'zc706-zynq7:']['zc706-zynq7' !='${MACHINE}']}"
#### Regular settings follow

# Yocto device-tree variables
YAML_CONSOLE_DEVICE_CONFIG:pn-device-tree ?= "ps7_uart_1"
YAML_MAIN_MEMORY_CONFIG:pn-device-tree ?= "ps7_ddr_0"
DT_PADDING_SIZE:pn-device-tree ?= "0x1000"
DTC_FLAGS:pn-device-tree ?= ""
YAML_DT_BOARD_FLAGS ?= "{BOARD zc706}"

# Yocto FSBL variables
YAML_SERIAL_CONSOLE_STDIN:pn-fsbl-firmware ?= "ps7_uart_1"
YAML_SERIAL_CONSOLE_STDOUT:pn-fsbl-firmware ?= "ps7_uart_1"

# Serial Console Settings
SERIAL_CONSOLES ?= "115200;ttyPS0"
YAML_SERIAL_CONSOLE_BAUDRATE ?= "115200"

# Yocto u-boot-xlnx variables

# Set DDR Base address for u-boot-xlnx-scr variables
DDR_BASEADDR ?= "0x0"
SKIP_APPEND_BASEADDR ?= "0"

# Yocto KERNEL Variables
UBOOT_ENTRYPOINT ?= "0x200000"
UBOOT_LOADADDRESS ?= "0x200000"
KERNEL_EXTRA_ARGS += "UIMAGE_LOADADDR=${UBOOT_ENTRYPOINT}"

QB_MEM = "-m 1024"
QEMU_HW_SERIAL = "-serial null -serial mon:stdio"

# Required generic machine inclusion
require conf/machine/zynq-generic.conf

# This is an 'XSCT' based BSP
XILINX_XSCT_VERSION = "2026.1"
XILINX_WITH_ESW = "xsct"

# Add system XSA
HDF_URI = "https://edf.amd.com/sswreleases/rel-v2026.1/hdf-examples/2026.1/2026.1_0525_1_05260156/external/zc706-zynq7/zc706-zynq7-2026.1_0525_1.xsa"
HDF_URI[sha256sum] = "964d65780e0f907c72b4c3938b88d51d88f002f1ab737afb5364c8960f06eaa3"

#### No additional settings should be after the Postamble
#### Postamble
PACKAGE_EXTRA_ARCHS:append = "${@['', ' zc706_zynq7']['zc706-zynq7' != '${MACHINE}']}"
```

## conf/machine/zcu216-zynqmp-2026.1.conf
```bitbake
#@TYPE: Machine
#@NAME: zcu216-zynqmp
#@DESCRIPTION: Machine configuration for the zcu216-zynqmp boards.


#### Preamble
MACHINEOVERRIDES =. "${@['', 'zcu216-zynqmp:']['zcu216-zynqmp' !='${MACHINE}']}"
#### Regular settings follow

# Yocto device-tree variables
YAML_CONSOLE_DEVICE_CONFIG:pn-device-tree ?= "psu_uart_0"
YAML_MAIN_MEMORY_CONFIG:pn-device-tree ?= "psu_ddr_0"
DT_PADDING_SIZE:pn-device-tree ?= "0x1000"
DTC_FLAGS:pn-device-tree ?= ""
YAML_DT_BOARD_FLAGS ?= "{BOARD zcu216-reva}"

# Yocto PMUFW variables
YAML_COMPILER_FLAGS:append:pn-pmu-firmware = " "
YAML_SERIAL_CONSOLE_STDIN:pn-pmu-firmware ?= "psu_uart_0"
YAML_SERIAL_CONSOLE_STDOUT:pn-pmu-firmware ?= "psu_uart_0"

# Yocto FSBL variables
YAML_SERIAL_CONSOLE_STDIN:pn-fsbl-firmware ?= "psu_uart_0"
YAML_SERIAL_CONSOLE_STDOUT:pn-fsbl-firmware ?= "psu_uart_0"

# Serial Console Settings
SERIAL_CONSOLES ?= "115200;ttyPS0"
YAML_SERIAL_CONSOLE_BAUDRATE ?= "115200"

# Yocto arm-trusted-firmware(TF-A) variables
TFA_CONSOLE ?= "cadence"
TFA_BL33_LOAD ?= "0x8000000"

# Yocto u-boot-xlnx variables

# Set DDR Base address for u-boot-xlnx-scr variables
DDR_BASEADDR ?= "0x0"
SKIP_APPEND_BASEADDR ?= "0"

# Yocto KERNEL Variables
UBOOT_ENTRYPOINT ?= "0x200000"
UBOOT_LOADADDRESS ?= "0x200000"

# Yocto MACHINE_FEATURES Variable
MACHINE_FEATURES += "rfsoc"

# Required generic machine inclusion
require conf/machine/zynqmp-generic.conf

# This is an 'XSCT' based BSP
XILINX_XSCT_VERSION = "2026.1"
XILINX_WITH_ESW = "xsct"

# Add system XSA
HDF_URI = "https://edf.amd.com/sswreleases/rel-v2026.1/hdf-examples/2026.1/2026.1_0605_1_06052143/external/zcu216-zynqmp/zcu216-zynqmp-2026.1_0605_1.xsa"
HDF_URI[sha256sum] = "e595fbfc23623581ed88c293432f8e9f713cef676af0417bc87c4892837d2eed"

#### No additional settings should be after the Postamble
#### Postamble
PACKAGE_EXTRA_ARCHS:append = "${@['', ' zcu216_zynqmp']['zcu216-zynqmp' != '${MACHINE}']}"
```
